## CMakeLists.txt
```
# nRF54L15 DK — nRF Connect SDK / Zephyr project
#
# Build:
#   west build -b nrf54l15dk/nrf54l15/cpuapp -p always

cmake_minimum_required(VERSION 3.20.0)
find_package(ZEPHYR REQUIRED HINTS $ENV{ZEPHYR_BASE})

project(pq_ble_gatt_skeleton)

set(MLKEM_NATIVE_DIR
    ${CMAKE_CURRENT_SOURCE_DIR}/third_party/mlkem-native/mlkem
)

target_sources(app PRIVATE
    src/main.c
    src/mlkem_session.c
    src/mlkem_selftest.c
    src/pq_secure_channel.c
    src/pq_phase5.c
    src/pq_phase6.c
    src/pq_phase7.c
    ${MLKEM_NATIVE_DIR}/mlkem_native.c
)

# v1.0 profile (firmware/v1_smp_l4_mlkem.conf): BLE SMP Security Mode 1
# Level 4 gating, Numeric Comparison UI and the PQV1 control framing.
target_sources_ifdef(CONFIG_PQ_PROFILE_V10_SMP_L4_MLKEM app PRIVATE
    src/pq_v1_security.c
    src/pq_v1_frame.c
    src/pq_v1_cp2.c
    src/pq_v1_cp3.c
    src/pq_v1_cp4.c
)
target_sources_ifdef(CONFIG_PQ_PROFILE_V11_SMP_L4_MLKEM_RESUME app PRIVATE src/pq_v1_security.c)
target_sources_ifdef(CONFIG_PQ_RESUMPTION app PRIVATE
    src/pq_resume.c src/pq_resume_service.c
    src/pq_v1_frame.c src/pq_v1_cp2.c src/pq_v1_cp3.c src/pq_v1_cp4.c
)

target_include_directories(app PRIVATE
    ${MLKEM_NATIVE_DIR}
)

# ML-KEM-768 portable-C integration. Runtime KeyGen supplies production
# randomness to the deterministic API; the randomized mlkem-native wrapper is
# intentionally omitted so the vendored source needs no platform RNG shim.
# Native arithmetic and FIPS-202 backends are intentionally not enabled.
target_compile_definitions(app PRIVATE
    MLK_CONFIG_PARAMETER_SET=768
    MLK_CONFIG_NO_RANDOMIZED_API
    MLK_CONFIG_NAMESPACE_PREFIX=pqble_mlkem
    MLK_CONFIG_INTERNAL_API_QUALIFIER=static
)
```

## Kconfig
```
mainmenu "PQ-BLE Phase 2 firmware"

menu "PQ-BLE application options"

choice PQ_PROFILE
	prompt "PQ-BLE protocol profile"
	default PQ_PROFILE_V07_HYBRID
	help
	  Select which experimental architecture the firmware implements.
	  The two profiles share the GATT layout, the ML-KEM-768 worker, the
	  ciphertext fragmentation and the PSA-based secure channel.

config PQ_PROFILE_V07_HYBRID
	bool "v0.7: application-level hybrid ML-KEM-768 + P-256 (CONFIG_BT_SMP=n)"
	help
	  Frozen experimental baseline. BLE SMP is disabled; peer
	  authentication (SAS Numeric Comparison), the classical P-256 ECDH
	  and key confirmation are all performed by the application protocol
	  over GATT. This is the default and matches prj.conf.

config PQ_PROFILE_V10_SMP_L4_MLKEM
	bool "v1.0: BLE SMP Security Mode 1 Level 4 + ML-KEM-768"
	depends on BT_SMP
	help
	  Layered classical/PQ architecture. Peer authentication and BLE link
	  encryption are delegated to BLE SMP (authenticated LE Secure
	  Connections, Numeric Comparison, Security Level 4). The PQ GATT
	  characteristics are inaccessible until Level 4 is established, both
	  through BT_GATT_PERM_*_AUTHEN | BT_GATT_PERM_*_LESC and through an
	  explicit runtime security check in every sensitive GATT callback.
	  The v0.x application-level control frames are rejected in this
	  profile. Select with firmware/v1_smp_l4_mlkem.conf.

config PQ_PROFILE_V08_RESUME_HYBRID
	bool "v0.8: hybrid full authentication + application resumption"
	depends on !BT_SMP
	select PQ_RESUMPTION

config PQ_PROFILE_V11_SMP_L4_MLKEM_RESUME
	bool "v1.1: SMP L4 + ML-KEM full authentication + application resumption"
	depends on BT_SMP
	select PQ_RESUMPTION

endchoice

config PQ_RESUMPTION
	bool
	help
	  Dedicated symmetric ticket roots in RAM; never persist traffic keys.

if PQ_PROFILE_V10_SMP_L4_MLKEM || PQ_PROFILE_V11_SMP_L4_MLKEM_RESUME

config PQ_V1_CP3_TIMEOUT_MS
	int "CP3 absolute handshake deadline (milliseconds)"
	default 30000
	range 1000 120000
	help
	  Bounds START_CP3 through FINISHED_P queueing, including worker time.
	  Failure consumes the transaction; reconnect to start another CP3.

config PQ_V1_NUMERIC_COMPARISON_TIMEOUT_MS
	int "Numeric Comparison human-confirmation timeout (milliseconds)"
	default 60000
	range 5000 300000
	help
	  If no accept/reject decision is taken on the DK within this time,
	  the pending Numeric Comparison is cancelled with
	  bt_conn_auth_cancel() and the link is disconnected (fail closed).

config PQ_V1_BUTTON_UI
	bool "Use DK buttons for Numeric Comparison ACCEPT / REJECT"
	default y
	depends on DK_LIBRARY
	help
	  DK_BTN1 (devicetree sw0, silkscreen "BUTTON 0") accepts the
	  displayed six-digit value, DK_BTN2 (sw1, "BUTTON 1") rejects it and
	  DK_BTN4 (sw3, "BUTTON 3") deletes all stored bonds while idle.
	  Without this option the firmware never confirms a Numeric
	  Comparison: pairing can only time out or be rejected.

config PQ_V1_CLEAR_BONDS_ON_BOOT
	bool "TEST ONLY: delete every stored bond at boot"
	default n
	help
	  Forces the cold-pairing scenario on every reset by calling
	  bt_unpair(BT_ID_DEFAULT, BT_ADDR_LE_ANY) right after settings_load().
	  Never enable this in a bonded-reconnection benchmark build.

endif # PQ_PROFILE_V10_SMP_L4_MLKEM

config PQ_MLKEM_PHASE1_SELFTEST
	bool "Run the full Phase 1 ML-KEM startup self-test"
	default n
	help
	  Run the frozen deterministic KeyGen -> Encapsulation ->
	  Decapsulation regression test before the Phase 2 session worker starts.
	  This is test-only behavior and is disabled for normal Phase 2 boots.

config PQ_MLKEM_THREAD_STACK_SIZE
	int "Dedicated ML-KEM worker stack size"
	default 28672
	range 28672 28672
	help
	  Initial conservative stack allocation for Phase 2 KeyGen and
	  Decapsulation. Keep this at 28672 bytes until on-device watermark data
	  justifies a separate stack-optimization milestone.

config PQ_MLKEM_THREAD_PRIORITY
	int "Dedicated ML-KEM worker preemptible priority"
	default 14
	range 14 14
	help
	  NCS 3.0.0 configures 15 preemptible priorities (0 through 14), making
	  14 the lowest-priority application thread. Bluetooth and system
	  processing can therefore preempt the CPU-intensive ML-KEM worker.

endmenu

source "Kconfig.zephyr"
```

## prj.conf
```kconfig
# Bluetooth core
CONFIG_BT=y
CONFIG_BT_PERIPHERAL=y
CONFIG_BT_DEVICE_NAME="PQ-BLE-Device"
CONFIG_BT_DEVICE_APPEARANCE=0

# No BLE Security Manager pairing.
# PQ-BLE provides security at application layer.
CONFIG_BT_SMP=n

# GATT / ATT
CONFIG_BT_ATT_PREPARE_COUNT=4
CONFIG_BT_L2CAP_TX_MTU=517

# Buffers
CONFIG_BT_BUF_ACL_RX_SIZE=251
CONFIG_BT_BUF_ACL_TX_SIZE=251
CONFIG_BT_BUF_ACL_RX_COUNT=10
CONFIG_BT_BUF_ACL_TX_COUNT=10

# Stack sizes
# Keep the validated Phase 1 main-stack allocation unchanged for this first
# integration build. Normal Phase 2 KeyGen and Decapsulation execute only on
# the dedicated worker configured below.
CONFIG_MAIN_STACK_SIZE=24576
CONFIG_SYSTEM_WORKQUEUE_STACK_SIZE=4096
CONFIG_PQ_MLKEM_THREAD_STACK_SIZE=28672
CONFIG_PQ_MLKEM_THREAD_PRIORITY=14

# Thread stack high-water mark measurement. Both options are required by
# k_thread_stack_space_get() in the Zephyr version supplied with NCS 3.0.0.
CONFIG_INIT_STACKS=y
CONFIG_THREAD_STACK_INFO=y

# CRC-32/IEEE for the TEST-ONLY shared-secret diagnostic checksum.
CONFIG_CRC=y

# Phase 3: PSA Crypto for HKDF-SHA256 and AES-256-GCM
CONFIG_NRF_SECURITY=y
CONFIG_MBEDTLS_PSA_CRYPTO_C=y

CONFIG_PSA_WANT_ALG_SHA_256=y
CONFIG_PSA_WANT_ALG_HMAC=y
CONFIG_PSA_WANT_ALG_HKDF=y
CONFIG_PSA_WANT_ALG_GCM=y

CONFIG_PSA_WANT_KEY_TYPE_DERIVE=y
CONFIG_PSA_WANT_KEY_TYPE_HMAC=y
CONFIG_PSA_WANT_KEY_TYPE_AES=y
CONFIG_PSA_WANT_AES_KEY_SIZE_256=y

CONFIG_PSA_WANT_GENERATE_RANDOM=y

# Phase 7 Checkpoint 1: minimum PSA P-256 ECDH capabilities.
CONFIG_PSA_WANT_ALG_ECDH=y
CONFIG_PSA_WANT_ECC_SECP_R1_256=y
CONFIG_PSA_WANT_KEY_TYPE_ECC_KEY_PAIR_GENERATE=y
CONFIG_PSA_WANT_KEY_TYPE_ECC_KEY_PAIR_EXPORT=y
# NCS 3.0.0 Cracen gates ECC public-key import/validation on this symbol.
CONFIG_PSA_WANT_KEY_TYPE_ECC_KEY_PAIR_IMPORT=y

# Logging
CONFIG_LOG=y
CONFIG_LOG_DEFAULT_LEVEL=3
```

## phase1_selftest.conf
```kconfig
# Optional regression profile: enable the frozen Phase 1 full local
# KeyGen -> Encapsulation -> Decapsulation startup self-test.
# TEST ONLY - NOT FOR PRODUCTION
CONFIG_PQ_MLKEM_PHASE1_SELFTEST=y
```

## v08_resume_hybrid.conf
```kconfig
# v0.8: SMP disabled, full hybrid authentication and RAM application tickets.
CONFIG_PQ_PROFILE_V08_RESUME_HYBRID=y
# Resume SHA/HMAC executes in the GATT callback; application AES-GCM stays
# on the existing v0.7 crypto worker with the existing explicit-IV wire format.
CONFIG_BT_RX_STACK_SIZE=8192
```

## v11_smp_l4_mlkem_resume.conf
```kconfig
# Apply after v1_smp_l4_mlkem.conf to reuse its exact BLE protection settings.
CONFIG_PQ_PROFILE_V10_SMP_L4_MLKEM=n
CONFIG_PQ_PROFILE_V11_SMP_L4_MLKEM_RESUME=y
CONFIG_BT_RX_STACK_SIZE=8192
```

## v1_smp_l4_mlkem.conf
```kconfig
# v1.0 profile: BLE SMP Security Mode 1 Level 4 + ML-KEM-768
#
# Build (from the firmware directory):
#   west build -b nrf54l15dk/nrf54l15/cpuapp -p always -- \
#     -DCONF_FILE=prj.conf -DEXTRA_CONF_FILE=v1_smp_l4_mlkem.conf
#
# prj.conf remains the unmodified v0.7 baseline (CONFIG_BT_SMP=n). This
# fragment is applied after prj.conf, so its assignments win. Every symbol
# below was checked against nRF Connect SDK 3.0.0 / sdk-zephyr v4.0.99-ncs1.

# Select the v1.0 application profile (firmware/Kconfig).
CONFIG_PQ_PROFILE_V10_SMP_L4_MLKEM=y

# --- Security Manager: authenticated LE Secure Connections only -------------
# BT_SMP_SC_ONLY selects BT_SMP_SC_PAIR_ONLY (legacy pairing disabled) and
# forces every bt_conn_set_security() request to BT_SECURITY_L4. The host
# rejects Just Works with "authentication requirements" because L4 needs an
# authenticated method (subsys/bluetooth/host/smp.c, remote_sec_level_reachable).
CONFIG_BT_SMP=y
CONFIG_BT_SMP_SC_ONLY=y
# Default y; stated explicitly because L4 requires the MITM flag.
CONFIG_BT_SMP_ENFORCE_MITM=y
# Observe/restrict each incoming pairing attempt; this does not confirm NC.
CONFIG_BT_SMP_APP_PAIRING_ACCEPT=y
# Application explicitly restores bonds; cold pairing belongs to WinRT.
CONFIG_BT_GATT_AUTO_SEC_REQ=n
# Prompt hidden under BT_SMP_SC_ONLY; default 16. Stated for documentation.
CONFIG_BT_SMP_MIN_ENC_KEY_SIZE=16
# Bond the Windows Central; an unauthenticated peer may never replace a bond.
CONFIG_BT_BONDABLE=y
CONFIG_BT_SMP_ALLOW_UNAUTH_OVERWRITE=n
CONFIG_BT_MAX_PAIRED=2

# --- Bond persistence (Scenario B: bonded reconnection) ----------------------
# nRF54L15 RRAM: 4 KiB erase blocks, 36 KiB "storage" fixed partition in the
# board devicetree -> 9 ZMS sectors. Zephyr's SETTINGS_BACKEND choice picks
# SETTINGS_ZMS automatically when ZMS=y. settings_load() is called from
# main() after bt_enable() (see pq_v1_security_settings_load()).
CONFIG_FLASH=y
CONFIG_FLASH_MAP=y
CONFIG_ZMS=y
CONFIG_SETTINGS=y
CONFIG_BT_SETTINGS=y

# --- Human Numeric Comparison confirmation on the DK -------------------------
# Nordic DK button/LED library (selects GPIO). DK_BTN1 = devicetree sw0 =
# silkscreen "BUTTON 0" on the nRF54L15 DK.
CONFIG_DK_LIBRARY=y

# BT_ECC (selected by BT_SMP) performs the SMP P-256 ECDH through PSA Crypto;
# the required PSA_WANT_* symbols are already enabled by prj.conf.
```

## src/mlkem_selftest.c
```c
/*
 * Deterministic ML-KEM-768 startup self-test.
 *
 * TEST ONLY - NOT FOR PRODUCTION
 *
 * The fixed coins below exist only to prove that the portable mlkem-native
 * implementation executes correctly on the target. They are not random and
 * must never be used for production key generation or encapsulation.
 */

#include "mlkem_selftest.h"

#include <string.h>

#include <zephyr/kernel.h>
#include <zephyr/logging/log.h>

#include <mlkem_native.h>

LOG_MODULE_REGISTER(mlkem_selftest, LOG_LEVEL_INF);

_Static_assert(MLK_CONFIG_PARAMETER_SET == 768,
               "mlkem-native must be configured for ML-KEM-768");
_Static_assert(MLKEM_PUBLICKEYBYTES(MLK_CONFIG_PARAMETER_SET) == 1184,
               "Unexpected ML-KEM-768 public-key size");
_Static_assert(MLKEM_SECRETKEYBYTES(MLK_CONFIG_PARAMETER_SET) == 2400,
               "Unexpected ML-KEM-768 secret-key size");
_Static_assert(MLKEM_CIPHERTEXTBYTES(MLK_CONFIG_PARAMETER_SET) == 1088,
               "Unexpected ML-KEM-768 ciphertext size");
_Static_assert(MLKEM_BYTES == 32,
               "Unexpected ML-KEM shared-secret size");

/* File-static buffers keep the test vectors off the main thread stack. */
static uint8_t selftest_pk[
    MLKEM_PUBLICKEYBYTES(MLK_CONFIG_PARAMETER_SET)];
static uint8_t selftest_sk[
    MLKEM_SECRETKEYBYTES(MLK_CONFIG_PARAMETER_SET)];
static uint8_t selftest_ct[
    MLKEM_CIPHERTEXTBYTES(MLK_CONFIG_PARAMETER_SET)];
static uint8_t selftest_ss_enc[MLKEM_BYTES];
static uint8_t selftest_ss_dec[MLKEM_BYTES];

/* TEST ONLY - NOT FOR PRODUCTION: fixed deterministic key-generation coins. */
static const uint8_t selftest_keygen_coins[2 * MLKEM_SYMBYTES] = {
    0x00, 0x01, 0x02, 0x03, 0x04, 0x05, 0x06, 0x07,
    0x08, 0x09, 0x0a, 0x0b, 0x0c, 0x0d, 0x0e, 0x0f,
    0x10, 0x11, 0x12, 0x13, 0x14, 0x15, 0x16, 0x17,
    0x18, 0x19, 0x1a, 0x1b, 0x1c, 0x1d, 0x1e, 0x1f,
    0x20, 0x21, 0x22, 0x23, 0x24, 0x25, 0x26, 0x27,
    0x28, 0x29, 0x2a, 0x2b, 0x2c, 0x2d, 0x2e, 0x2f,
    0x30, 0x31, 0x32, 0x33, 0x34, 0x35, 0x36, 0x37,
    0x38, 0x39, 0x3a, 0x3b, 0x3c, 0x3d, 0x3e, 0x3f,
};

/* TEST ONLY - NOT FOR PRODUCTION: fixed deterministic encapsulation coins. */
static const uint8_t selftest_encaps_coins[MLKEM_SYMBYTES] = {
    0x40, 0x41, 0x42, 0x43, 0x44, 0x45, 0x46, 0x47,
    0x48, 0x49, 0x4a, 0x4b, 0x4c, 0x4d, 0x4e, 0x4f,
    0x50, 0x51, 0x52, 0x53, 0x54, 0x55, 0x56, 0x57,
    0x58, 0x59, 0x5a, 0x5b, 0x5c, 0x5d, 0x5e, 0x5f,
};

void mlkem_selftest_report_main_stack(const char *checkpoint)
{
    size_t unused_stack;
    int ret;

    LOG_INF("Cumulative main-thread stack high-water mark: %s", checkpoint);
    LOG_INF("Configured main stack: %u B",
            (unsigned int)CONFIG_MAIN_STACK_SIZE);

    ret = k_thread_stack_space_get(k_current_get(), &unused_stack);
    if (ret != 0) {
        LOG_ERR("Main stack watermark unavailable (error %d)", ret);
        return;
    }

    LOG_INF("Unused main stack: %zu B", unused_stack);

    if (unused_stack <= CONFIG_MAIN_STACK_SIZE) {
        LOG_INF("Estimated cumulative peak stack "
                "(configured - unused): %zu B",
                (size_t)CONFIG_MAIN_STACK_SIZE - unused_stack);
    } else {
        LOG_WRN("Main stack watermark exceeds configured size");
    }
}

bool mlkem_selftest_run(void)
{
    int ret;

    LOG_INF("=== ML-KEM-768 self-test ===");
    LOG_INF("Public key size: %u",
            (unsigned int)sizeof(selftest_pk));
    LOG_INF("Secret key size: %u",
            (unsigned int)sizeof(selftest_sk));
    LOG_INF("Ciphertext size: %u",
            (unsigned int)sizeof(selftest_ct));
    LOG_INF("Shared secret size: %u",
            (unsigned int)sizeof(selftest_ss_enc));

    ret = pqble_mlkem_keypair_derand(selftest_pk, selftest_sk,
                                     selftest_keygen_coins);
    mlkem_selftest_report_main_stack("after ML-KEM KeyGen");
    if (ret != 0) {
        LOG_ERR("Key generation: FAIL (error %d)", ret);
        goto fail;
    }
    LOG_INF("Key generation: OK");

    ret = pqble_mlkem_enc_derand(selftest_ct, selftest_ss_enc,
                                 selftest_pk, selftest_encaps_coins);
    mlkem_selftest_report_main_stack("after ML-KEM Encapsulation");
    if (ret != 0) {
        LOG_ERR("Encapsulation: FAIL (error %d)", ret);
        goto fail;
    }
    LOG_INF("Encapsulation: OK");

    ret = pqble_mlkem_dec(selftest_ss_dec, selftest_ct, selftest_sk);
    mlkem_selftest_report_main_stack("after ML-KEM Decapsulation");
    if (ret != 0) {
        LOG_ERR("Decapsulation: FAIL (error %d)", ret);
        goto fail;
    }
    LOG_INF("Decapsulation: OK");

    if (memcmp(selftest_ss_enc, selftest_ss_dec,
               sizeof(selftest_ss_enc)) != 0) {
        LOG_ERR("Shared secret match: NO");
        goto fail;
    }

    LOG_INF("Shared secret match: YES");
    LOG_INF("ML-KEM-768 SELF TEST: PASS");
    return true;

fail:
    LOG_ERR("ML-KEM-768 SELF TEST: FAIL");
    return false;
}
```

## src/mlkem_selftest.h
```c
/*
 * Deterministic ML-KEM-768 startup self-test.
 *
 * TEST ONLY - NOT FOR PRODUCTION
 */

#ifndef PQ_BLE_MLKEM_SELFTEST_H_
#define PQ_BLE_MLKEM_SELFTEST_H_

#include <stdbool.h>

bool mlkem_selftest_run(void);
void mlkem_selftest_report_main_stack(const char *checkpoint);

#endif /* PQ_BLE_MLKEM_SELFTEST_H_ */
```

## src/mlkem_session.h
```c
/* ML-KEM-768 session worker shared by the isolated protocol modes. */

#ifndef PQ_BLE_MLKEM_SESSION_H_
#define PQ_BLE_MLKEM_SESSION_H_

#include <stdbool.h>
#include <stddef.h>
#include <stdint.h>

#include <mlkem_native.h>

#include "pq_phase5.h"
#include "pq_phase7.h"
#include "pq_secure_channel.h"


#define PQ_MLKEM_PUBLIC_KEY_SIZE \
	MLKEM_PUBLICKEYBYTES(MLK_CONFIG_PARAMETER_SET)

#define PQ_MLKEM_SECRET_KEY_SIZE \
	MLKEM_SECRETKEYBYTES(MLK_CONFIG_PARAMETER_SET)

#define PQ_MLKEM_CIPHERTEXT_SIZE \
	MLKEM_CIPHERTEXTBYTES(MLK_CONFIG_PARAMETER_SET)

#define PQ_MLKEM_SHARED_SECRET_SIZE MLKEM_BYTES
#define PQ_MLKEM_DIAGNOSTIC_SIZE 9U


/*
 * Phase 6 Checkpoint 2 deliberately supports small application frames only.
 * Large-message fragmentation is outside this checkpoint.
 */
#define PQ_MLKEM_PHASE6_MAX_PLAINTEXT_SIZE 64U

#define PQ_MLKEM_PHASE6_MAX_SECURE_WIRE_SIZE \
	(PQ_MLKEM_PHASE6_MAX_PLAINTEXT_SIZE + \
	 PQ_SECURE_FIXED_OVERHEAD)

/*
 * v0.7 authenticated application traffic uses the same
 * generic AES-256-GCM wire as Phase 6, but independent keys/state.
 */
#define PQ_MLKEM_PHASE7_MAX_PLAINTEXT_SIZE 64U

#define PQ_MLKEM_PHASE7_MAX_SECURE_WIRE_SIZE \
	(PQ_MLKEM_PHASE7_MAX_PLAINTEXT_SIZE + \
	 PQ_SECURE_FIXED_OVERHEAD)

enum pq_mlkem_diagnostic_status {
	PQ_MLKEM_STATUS_SUCCESS = 0x00,
	PQ_MLKEM_STATUS_KEYPAIR_UNAVAILABLE = 0x01,
	PQ_MLKEM_STATUS_CIPHERTEXT_INCOMPLETE = 0x02,
	PQ_MLKEM_STATUS_DECAPSULATION_FAILURE = 0x03,
	PQ_MLKEM_STATUS_INVALID_PROTOCOL_STATE = 0x04,
	PQ_MLKEM_STATUS_SECURE_CHANNEL_FAILURE = 0x05,
	PQ_MLKEM_STATUS_AUTHENTICATION_FAILURE = 0x06,
};


enum pq_mlkem_job_mode {
	PQ_MLKEM_JOB_PHASE2_DIAGNOSTIC = 0,
	PQ_MLKEM_JOB_PHASE3_SECURE = 1,
	PQ_MLKEM_JOB_PHASE5_START = 2,
	PQ_MLKEM_JOB_PHASE5_FINISHED_C = 3,
	PQ_MLKEM_JOB_PHASE5_DATA = 4,
	PQ_MLKEM_JOB_PHASE6_C2P = 5,
	PQ_MLKEM_JOB_PHASE7_HYBRID_CP2 = 6,
	PQ_MLKEM_JOB_PHASE7_AUTH_START = 7,
	PQ_MLKEM_JOB_PHASE7_AUTH_FINISHED_C = 8,
	PQ_MLKEM_JOB_PHASE7_APP_C2P = 9,
	PQ_MLKEM_JOB_V1_CP2 = 10,
	PQ_MLKEM_JOB_V1_CP3 = 11,
	PQ_MLKEM_JOB_V1_CP3_FINISHED_C = 12,
	PQ_MLKEM_JOB_V1_CP4_C2P = 13,
};


typedef void (*pq_mlkem_result_callback_t)(
	enum pq_mlkem_job_mode mode,
	enum pq_mlkem_diagnostic_status status,
	uint32_t shared_secret_crc32,
	const uint8_t *secure_wire,
	size_t secure_wire_len);


/*
 * Start the dedicated worker and wait for production-random on-device KeyGen.
 * KeyGen executes in the worker, never in the caller's thread.
 */
int pq_mlkem_session_init(
	pq_mlkem_result_callback_t result_callback);


bool pq_mlkem_session_keypair_ready(void);

#if defined(CONFIG_PQ_PROFILE_V10_SMP_L4_MLKEM) || defined(CONFIG_PQ_PROFILE_V11_SMP_L4_MLKEM_RESUME)
int pq_mlkem_session_submit_v1_cp3(
	const uint8_t *ciphertext, size_t ciphertext_len,
	const uint8_t *sec_info, size_t sec_info_len,
	const uint8_t *start, size_t start_len);
int pq_mlkem_session_submit_v1_cp3_finished_c(const uint8_t *frame, size_t len);
/* Promote pending keys only after FINISHED_P queued to the live owner. */
int pq_mlkem_session_commit_v1_cp3(void);
void pq_mlkem_session_reset_v1_cp3(void);
int pq_mlkem_session_submit_v1_cp4(const uint8_t *frame, size_t len);
int pq_mlkem_session_commit_v1_cp4(void);
/* Implemented by the connection owner; called with no session lock held. */
bool pq_v1_cp4_job_live(void);

/* Explicit v1 path: copies CT + public session context, retains no app key. */
int pq_mlkem_session_submit_v1_cp2(
	const uint8_t *ciphertext, size_t ciphertext_len,
	const uint8_t *session_id, size_t session_id_len);

/* Invalidate pending/running work. Only the worker wipes its active inputs. */
void pq_mlkem_session_reset_v1_cp2(void);
#endif


/* The returned immutable public key remains valid for the lifetime of the DK. */
const uint8_t *pq_mlkem_session_public_key(
	size_t *public_key_len);


/*
 * Copy one complete ciphertext into the single-slot worker job and wake the
 * worker. Returns zero only when the ciphertext has been accepted.
 */
int pq_mlkem_session_submit(
	const uint8_t *ciphertext,
	size_t ciphertext_len);


int pq_mlkem_session_submit_secure(
	const uint8_t *ciphertext,
	size_t ciphertext_len,
	const uint8_t session_id[PQ_SECURE_SESSION_ID_SIZE]);


int pq_mlkem_session_submit_phase5(
	const uint8_t *ciphertext,
	size_t ciphertext_len,
	const uint8_t session_id[PQ_PHASE5_SESSION_ID_SIZE]);

/* CT/session/peer public key are copied; heavy crypto executes in the worker. */
int pq_mlkem_session_submit_phase7_cp2(
	const uint8_t *ciphertext, size_t ciphertext_len,
	const uint8_t session_id[PQ_PHASE7_SESSION_ID_SIZE],
	const uint8_t central_public_key[PQ_PHASE7_P256_PUBLIC_KEY_SIZE]);

int pq_mlkem_session_submit_phase7_auth(
	const uint8_t *ciphertext,
	size_t ciphertext_len,
	const uint8_t session_id[
		PQ_PHASE7_SESSION_ID_SIZE],
	const uint8_t central_public_key[
		PQ_PHASE7_P256_PUBLIC_KEY_SIZE]);

int pq_mlkem_session_submit_phase7_finished_c(
	const uint8_t finished_c[
		PQ_PHASE7_FINISHED_SIZE]);

		/*
 * Called only after FINISHED_P has been successfully queued
 * to the originating live BLE connection.
 *
 * No cryptography is performed here: it atomically promotes
 * already-derived pending v0.7 traffic keys to active state.
 */
int pq_mlkem_session_commit_phase7_authenticated(void);
#if defined(CONFIG_PQ_PROFILE_V08_RESUME_HYBRID)
int pq_mlkem_session_install_phase8_application(const uint8_t c2p[32],
	const uint8_t p2c[32], const uint8_t sid[16]);
#endif


/*
 * Submit one authenticated v0.7 Central -> Peripheral
 * application frame to the crypto worker.
 */
int pq_mlkem_session_submit_phase7_c2p(
	const uint8_t *secure_wire,
	size_t secure_wire_len);
	
void pq_mlkem_session_reset_phase7(void);

int pq_mlkem_session_submit_phase5_finished_c(
	const uint8_t finished_c[PQ_PHASE5_FINISHED_SIZE]);


int pq_mlkem_session_submit_phase5_data(void);


/*
 * Submit one encrypted Central -> Peripheral Phase 6 application frame.
 *
 * The actual AES-GCM verification/decryption runs on the existing crypto
 * worker, never in the GATT write callback.
 */
int pq_mlkem_session_submit_phase6_c2p(
	const uint8_t *secure_wire,
	size_t secure_wire_len);


/*
 * Cancel the current authenticated epoch and wipe all retained Phase 5/6
 * session material. Also invalidates pending/running CP2 jobs; the worker
 * wipes their temporary buffers before delivery, without retaining keys.
 */
void pq_mlkem_session_reset_phase5(void);


#endif /* PQ_BLE_MLKEM_SESSION_H_ */
```

## src/pq_phase5.c
```c
#include "pq_phase5.h"

#include <errno.h>
#include <string.h>

#include <psa/crypto.h>

#include <zephyr/sys/util.h>

static const uint8_t phase5_domain[] = "PQ-BLE-HANDSHAKE-v0.5";
static const uint8_t phase5_kdf_info[] =
	"PQ-BLE-HANDSHAKE-v0.5/key-schedule";
static const uint8_t phase5_sas_label[] = "PQ-BLE-HANDSHAKE-v0.5/SAS";
static const uint8_t phase5_finished_c_label[] =
	"PQ-BLE-HANDSHAKE-v0.5/FINISHED/C";
static const uint8_t phase5_finished_p_label[] =
	"PQ-BLE-HANDSHAKE-v0.5/FINISHED/P";

static const uint8_t central_role[] = { 0x01U };
static const uint8_t peripheral_role[] = { 0x02U };

void pq_phase5_clear(void *buffer, size_t len)
{
	volatile uint8_t *cursor = buffer;

	while (len-- > 0U) {
		*cursor++ = 0U;
	}
}

static psa_status_t hash_length_prefixed(
	psa_hash_operation_t *operation,
	const uint8_t *field,
	size_t field_len)
{
	uint8_t length_be[2];
	psa_status_t status;

	if (field_len > UINT16_MAX) {
		return PSA_ERROR_INVALID_ARGUMENT;
	}

	length_be[0] = (uint8_t)(field_len >> 8);
	length_be[1] = (uint8_t)field_len;
	status = psa_hash_update(operation, length_be, sizeof(length_be));
	if (status != PSA_SUCCESS) {
		return status;
	}

	return psa_hash_update(operation, field, field_len);
}

int pq_phase5_transcript_hash(
	const uint8_t session_id[PQ_PHASE5_SESSION_ID_SIZE],
	const uint8_t public_key[PQ_PHASE5_PUBLIC_KEY_SIZE],
	const uint8_t ciphertext[PQ_PHASE5_CIPHERTEXT_SIZE],
	uint8_t transcript_hash[PQ_PHASE5_HASH_SIZE])
{
	psa_hash_operation_t operation = PSA_HASH_OPERATION_INIT;
	psa_status_t status;
	size_t hash_len = 0U;
	int ret = -EIO;

	if (session_id == NULL || public_key == NULL || ciphertext == NULL ||
	    transcript_hash == NULL) {
		return -EINVAL;
	}

	status = psa_hash_setup(&operation, PSA_ALG_SHA_256);
	if (status == PSA_SUCCESS) {
		status = hash_length_prefixed(
			&operation, phase5_domain, sizeof(phase5_domain) - 1U);
	}
	if (status == PSA_SUCCESS) {
		status = hash_length_prefixed(
			&operation, central_role, sizeof(central_role));
	}
	if (status == PSA_SUCCESS) {
		status = hash_length_prefixed(
			&operation, peripheral_role, sizeof(peripheral_role));
	}
	if (status == PSA_SUCCESS) {
		status = hash_length_prefixed(
			&operation, session_id, PQ_PHASE5_SESSION_ID_SIZE);
	}
	if (status == PSA_SUCCESS) {
		status = hash_length_prefixed(
			&operation, public_key, PQ_PHASE5_PUBLIC_KEY_SIZE);
	}
	if (status == PSA_SUCCESS) {
		status = hash_length_prefixed(
			&operation, ciphertext, PQ_PHASE5_CIPHERTEXT_SIZE);
	}

	if (status == PSA_SUCCESS) {
		status = psa_hash_finish(&operation, transcript_hash,
					 sizeof(uint8_t[PQ_PHASE5_HASH_SIZE]),
					 &hash_len);
	}

	if (status == PSA_SUCCESS && hash_len == PQ_PHASE5_HASH_SIZE) {
		ret = 0;
	}

	(void)psa_hash_abort(&operation);
	if (ret != 0) {
		pq_phase5_clear(transcript_hash, PQ_PHASE5_HASH_SIZE);
	}
	return ret;
}

int pq_phase5_derive_keys(
	const uint8_t shared_secret[PQ_PHASE5_SHARED_SECRET_SIZE],
	const uint8_t transcript_hash[PQ_PHASE5_HASH_SIZE],
	struct pq_phase5_keys *keys)
{
	psa_key_derivation_operation_t operation =
		PSA_KEY_DERIVATION_OPERATION_INIT;
	psa_status_t status;
	int ret = -EIO;

	if (shared_secret == NULL || transcript_hash == NULL || keys == NULL) {
		return -EINVAL;
	}
	BUILD_ASSERT(sizeof(*keys) == PQ_PHASE5_KEY_BLOCK_SIZE,
		     "Phase 5 key structure must match the HKDF split");

	status = psa_key_derivation_setup(
		&operation, PSA_ALG_HKDF(PSA_ALG_SHA_256));
	if (status == PSA_SUCCESS) {
		status = psa_key_derivation_input_bytes(
			&operation, PSA_KEY_DERIVATION_INPUT_SALT,
			transcript_hash, PQ_PHASE5_HASH_SIZE);
	}
	if (status == PSA_SUCCESS) {
		status = psa_key_derivation_input_bytes(
			&operation, PSA_KEY_DERIVATION_INPUT_SECRET,
			shared_secret, PQ_PHASE5_SHARED_SECRET_SIZE);
	}
	if (status == PSA_SUCCESS) {
		status = psa_key_derivation_input_bytes(
			&operation, PSA_KEY_DERIVATION_INPUT_INFO,
			phase5_kdf_info, sizeof(phase5_kdf_info) - 1U);
	}
	if (status == PSA_SUCCESS) {
		status = psa_key_derivation_output_bytes(
			&operation, (uint8_t *)keys, PQ_PHASE5_KEY_BLOCK_SIZE);
	}
	if (status == PSA_SUCCESS) {
		ret = 0;
	}

	(void)psa_key_derivation_abort(&operation);
	if (ret != 0) {
		pq_phase5_clear(keys, sizeof(*keys));
	}
	return ret;
}

static int hmac_sha256(
	const uint8_t key[PQ_PHASE5_KEY_SIZE],
	const uint8_t *label,
	size_t label_len,
	const uint8_t transcript_hash[PQ_PHASE5_HASH_SIZE],
	uint8_t output[PQ_PHASE5_HASH_SIZE])
{
	uint8_t input[64U];
	psa_key_attributes_t attributes = PSA_KEY_ATTRIBUTES_INIT;
	psa_key_id_t key_id = 0;
	psa_status_t status;
	size_t output_len = 0U;
	int ret = -EIO;

	if (key == NULL || label == NULL || transcript_hash == NULL ||
	    output == NULL || label_len + PQ_PHASE5_HASH_SIZE > sizeof(input)) {
		return -EINVAL;
	}

	memcpy(input, label, label_len);
	memcpy(input + label_len, transcript_hash, PQ_PHASE5_HASH_SIZE);

	psa_set_key_usage_flags(&attributes, PSA_KEY_USAGE_SIGN_MESSAGE);
	psa_set_key_algorithm(&attributes, PSA_ALG_HMAC(PSA_ALG_SHA_256));
	psa_set_key_type(&attributes, PSA_KEY_TYPE_HMAC);
	psa_set_key_bits(&attributes, PQ_PHASE5_KEY_SIZE * 8U);

	status = psa_import_key(&attributes, key, PQ_PHASE5_KEY_SIZE, &key_id);
	psa_reset_key_attributes(&attributes);
	if (status == PSA_SUCCESS) {
		status = psa_mac_compute(
			key_id, PSA_ALG_HMAC(PSA_ALG_SHA_256), input,
			label_len + PQ_PHASE5_HASH_SIZE, output,
			PQ_PHASE5_HASH_SIZE, &output_len);
	}
	if (status == PSA_SUCCESS && output_len == PQ_PHASE5_HASH_SIZE) {
		ret = 0;
	}

	if (key_id != 0) {
		(void)psa_destroy_key(key_id);
	}
	pq_phase5_clear(input, sizeof(input));
	if (ret != 0) {
		pq_phase5_clear(output, PQ_PHASE5_HASH_SIZE);
	}
	return ret;
}

int pq_phase5_compute_sas(
	const uint8_t sas_key[PQ_PHASE5_KEY_SIZE],
	const uint8_t transcript_hash[PQ_PHASE5_HASH_SIZE],
	uint32_t *sas)
{
	uint8_t sas_mac[PQ_PHASE5_HASH_SIZE];
	uint32_t remainder = 0U;
	int ret;

	if (sas == NULL) {
		return -EINVAL;
	}

	ret = hmac_sha256(sas_key, phase5_sas_label,
			  sizeof(phase5_sas_label) - 1U,
			  transcript_hash, sas_mac);
	if (ret == 0) {
		for (size_t i = 0U; i < sizeof(sas_mac); ++i) {
			remainder = ((remainder * 256U) + sas_mac[i]) % 1000000U;
		}
		*sas = remainder;
	}
	pq_phase5_clear(sas_mac, sizeof(sas_mac));
	return ret;
}

static int compute_finished(
	const uint8_t finished_key[PQ_PHASE5_KEY_SIZE],
	const uint8_t *label,
	size_t label_len,
	const uint8_t transcript_hash[PQ_PHASE5_HASH_SIZE],
	uint8_t finished[PQ_PHASE5_FINISHED_SIZE])
{
	return hmac_sha256(finished_key, label, label_len,
			   transcript_hash, finished);
}

int pq_phase5_compute_finished_c(
	const uint8_t finished_key[PQ_PHASE5_KEY_SIZE],
	const uint8_t transcript_hash[PQ_PHASE5_HASH_SIZE],
	uint8_t finished[PQ_PHASE5_FINISHED_SIZE])
{
	return compute_finished(finished_key, phase5_finished_c_label,
				sizeof(phase5_finished_c_label) - 1U,
				transcript_hash, finished);
}

int pq_phase5_compute_finished_p(
	const uint8_t finished_key[PQ_PHASE5_KEY_SIZE],
	const uint8_t transcript_hash[PQ_PHASE5_HASH_SIZE],
	uint8_t finished[PQ_PHASE5_FINISHED_SIZE])
{
	return compute_finished(finished_key, phase5_finished_p_label,
				sizeof(phase5_finished_p_label) - 1U,
				transcript_hash, finished);
}

bool pq_phase5_finished_equal(
	const uint8_t expected[PQ_PHASE5_FINISHED_SIZE],
	const uint8_t received[PQ_PHASE5_FINISHED_SIZE])
{
	uint8_t difference = 0U;

	if (expected == NULL || received == NULL) {
		return false;
	}

	for (size_t i = 0U; i < PQ_PHASE5_FINISHED_SIZE; ++i) {
		difference |= expected[i] ^ received[i];
	}
	return difference == 0U;
}

int pq_phase5_encode_frame(
	uint8_t subtype,
	const uint8_t *payload,
	size_t payload_len,
	uint8_t *output,
	size_t output_capacity,
	size_t *output_len)
{
	static const uint8_t magic[] = PQ_PHASE5_FRAME_MAGIC;

	if (output == NULL || output_len == NULL || payload_len > UINT16_MAX ||
	    (payload_len > 0U && payload == NULL)) {
		return -EINVAL;
	}
	if (output_capacity < PQ_PHASE5_FRAME_HEADER_SIZE + payload_len) {
		return -ENOBUFS;
	}

	memcpy(output, magic, PQ_PHASE5_FRAME_MAGIC_SIZE);
	output[4] = PQ_PHASE5_FRAME_VERSION;
	output[5] = subtype;
	output[6] = (uint8_t)(payload_len >> 8);
	output[7] = (uint8_t)payload_len;
	if (payload_len > 0U) {
		memcpy(output + PQ_PHASE5_FRAME_HEADER_SIZE, payload, payload_len);
	}
	*output_len = PQ_PHASE5_FRAME_HEADER_SIZE + payload_len;
	return 0;
}

int pq_phase5_parse_frame(
	const uint8_t *frame,
	size_t frame_len,
	uint8_t *subtype,
	const uint8_t **payload,
	size_t *payload_len)
{
	static const uint8_t magic[] = PQ_PHASE5_FRAME_MAGIC;
	size_t declared_len;

	if (frame == NULL || subtype == NULL || payload == NULL ||
	    payload_len == NULL || frame_len < PQ_PHASE5_FRAME_HEADER_SIZE) {
		return -EINVAL;
	}
	if (memcmp(frame, magic, PQ_PHASE5_FRAME_MAGIC_SIZE) != 0 ||
	    frame[4] != PQ_PHASE5_FRAME_VERSION) {
		return -EINVAL;
	}
	declared_len = ((size_t)frame[6] << 8) | frame[7];
	if (frame_len != PQ_PHASE5_FRAME_HEADER_SIZE + declared_len) {
		return -EINVAL;
	}

	*subtype = frame[5];
	*payload = frame + PQ_PHASE5_FRAME_HEADER_SIZE;
	*payload_len = declared_len;
	return 0;
}
```

## src/pq_phase5.h
```c
/* Authenticated pure-PQ handshake primitives for protocol version 0.5. */

#ifndef PQ_PHASE5_H_
#define PQ_PHASE5_H_

#include <stdbool.h>
#include <stddef.h>
#include <stdint.h>

#define PQ_PHASE5_SESSION_ID_SIZE 16U
#define PQ_PHASE5_PUBLIC_KEY_SIZE 1184U
#define PQ_PHASE5_CIPHERTEXT_SIZE 1088U
#define PQ_PHASE5_SHARED_SECRET_SIZE 32U
#define PQ_PHASE5_HASH_SIZE 32U
#define PQ_PHASE5_KEY_SIZE 32U
#define PQ_PHASE5_KEY_BLOCK_SIZE (4U * PQ_PHASE5_KEY_SIZE)
#define PQ_PHASE5_FINISHED_SIZE 32U

#define PQ_PHASE5_FRAME_MAGIC "PQS5"
#define PQ_PHASE5_FRAME_MAGIC_SIZE 4U
#define PQ_PHASE5_FRAME_VERSION 0x05U
#define PQ_PHASE5_FRAME_HEADER_SIZE 8U

#define PQ_PHASE5_READY_FOR_SAS 0x01U
#define PQ_PHASE5_FINISHED_P 0x02U
#define PQ_PHASE5_ERROR 0x7fU
#define PQ_PHASE5_FINISHED_C 0x10U
#define PQ_PHASE5_DATA_REQUEST 0x11U

#define PQ_PHASE5_READY_FRAME_SIZE PQ_PHASE5_FRAME_HEADER_SIZE
#define PQ_PHASE5_FINISHED_FRAME_SIZE \
	(PQ_PHASE5_FRAME_HEADER_SIZE + PQ_PHASE5_FINISHED_SIZE)
#define PQ_PHASE5_ERROR_FRAME_SIZE (PQ_PHASE5_FRAME_HEADER_SIZE + 1U)

struct pq_phase5_keys {
	uint8_t application[PQ_PHASE5_KEY_SIZE];
	uint8_t sas[PQ_PHASE5_KEY_SIZE];
	uint8_t finished_c[PQ_PHASE5_KEY_SIZE];
	uint8_t finished_p[PQ_PHASE5_KEY_SIZE];
};

/*
 * SHA-256 over six ordered u16-big-endian-length-prefixed fields:
 * domain, Central role, Peripheral role, session_id, public key, ciphertext.
 */
int pq_phase5_transcript_hash(
	const uint8_t session_id[PQ_PHASE5_SESSION_ID_SIZE],
	const uint8_t public_key[PQ_PHASE5_PUBLIC_KEY_SIZE],
	const uint8_t ciphertext[PQ_PHASE5_CIPHERTEXT_SIZE],
	uint8_t transcript_hash[PQ_PHASE5_HASH_SIZE]);

/* HKDF-SHA256 with transcript_hash as salt and a 128-byte output. */
int pq_phase5_derive_keys(
	const uint8_t shared_secret[PQ_PHASE5_SHARED_SECRET_SIZE],
	const uint8_t transcript_hash[PQ_PHASE5_HASH_SIZE],
	struct pq_phase5_keys *keys);

/* Full-HMAC big-endian integer modulo 1,000,000. */
int pq_phase5_compute_sas(
	const uint8_t sas_key[PQ_PHASE5_KEY_SIZE],
	const uint8_t transcript_hash[PQ_PHASE5_HASH_SIZE],
	uint32_t *sas);

int pq_phase5_compute_finished_c(
	const uint8_t finished_key[PQ_PHASE5_KEY_SIZE],
	const uint8_t transcript_hash[PQ_PHASE5_HASH_SIZE],
	uint8_t finished[PQ_PHASE5_FINISHED_SIZE]);

int pq_phase5_compute_finished_p(
	const uint8_t finished_key[PQ_PHASE5_KEY_SIZE],
	const uint8_t transcript_hash[PQ_PHASE5_HASH_SIZE],
	uint8_t finished[PQ_PHASE5_FINISHED_SIZE]);

bool pq_phase5_finished_equal(
	const uint8_t expected[PQ_PHASE5_FINISHED_SIZE],
	const uint8_t received[PQ_PHASE5_FINISHED_SIZE]);

int pq_phase5_encode_frame(
	uint8_t subtype,
	const uint8_t *payload,
	size_t payload_len,
	uint8_t *output,
	size_t output_capacity,
	size_t *output_len);

int pq_phase5_parse_frame(
	const uint8_t *frame,
	size_t frame_len,
	uint8_t *subtype,
	const uint8_t **payload,
	size_t *payload_len);

void pq_phase5_clear(void *buffer, size_t len);

#endif /* PQ_PHASE5_H_ */
```

## src/pq_phase6.c
```c
#include "pq_phase6.h"

#include <errno.h>
#include <string.h>

#include <psa/crypto.h>


static const uint8_t phase6_c2p_label[] =
	"PQ-BLE-TRAFFIC-v0.6/CENTRAL-TO-PERIPHERAL";

static const uint8_t phase6_p2c_label[] =
	"PQ-BLE-TRAFFIC-v0.6/PERIPHERAL-TO-CENTRAL";


static void secure_clear(void *buffer, size_t len)
{
	volatile uint8_t *cursor = buffer;

	while (len-- > 0U) {
		*cursor++ = 0U;
	}
}


void pq_phase6_clear_traffic_keys(
	struct pq_phase6_traffic_keys *traffic_keys)
{
	if (traffic_keys == NULL) {
		return;
	}

	secure_clear(traffic_keys, sizeof(*traffic_keys));
}


static int compute_hmac_sha256(
	psa_key_id_t key_id,
	const uint8_t *input,
	size_t input_len,
	uint8_t output[PQ_PHASE6_TRAFFIC_KEY_SIZE])
{
	psa_status_t status;
	size_t output_len = 0U;

	if (input == NULL || output == NULL) {
		return -EINVAL;
	}

	status = psa_mac_compute(
		key_id,
		PSA_ALG_HMAC(PSA_ALG_SHA_256),
		input,
		input_len,
		output,
		PQ_PHASE6_TRAFFIC_KEY_SIZE,
		&output_len);

	if (status != PSA_SUCCESS ||
	    output_len != PQ_PHASE6_TRAFFIC_KEY_SIZE) {
		secure_clear(output, PQ_PHASE6_TRAFFIC_KEY_SIZE);
		return -EIO;
	}

	return 0;
}


int pq_phase6_derive_traffic_keys(
	const uint8_t application_root_key[PQ_PHASE6_TRAFFIC_KEY_SIZE],
	struct pq_phase6_traffic_keys *traffic_keys)
{
	psa_key_attributes_t attributes = PSA_KEY_ATTRIBUTES_INIT;
	psa_key_id_t key_id = 0;
	psa_status_t status;
	int ret = -EIO;

	if (application_root_key == NULL || traffic_keys == NULL) {
		return -EINVAL;
	}

	pq_phase6_clear_traffic_keys(traffic_keys);

	psa_set_key_usage_flags(
		&attributes,
		PSA_KEY_USAGE_SIGN_MESSAGE);

	psa_set_key_algorithm(
		&attributes,
		PSA_ALG_HMAC(PSA_ALG_SHA_256));

	psa_set_key_type(
		&attributes,
		PSA_KEY_TYPE_HMAC);

	psa_set_key_bits(
		&attributes,
		PQ_PHASE6_TRAFFIC_KEY_SIZE * 8U);

	status = psa_import_key(
		&attributes,
		application_root_key,
		PQ_PHASE6_TRAFFIC_KEY_SIZE,
		&key_id);

	psa_reset_key_attributes(&attributes);

	if (status != PSA_SUCCESS) {
		goto out;
	}

	ret = compute_hmac_sha256(
		key_id,
		phase6_c2p_label,
		sizeof(phase6_c2p_label) - 1U,
		traffic_keys->central_to_peripheral);

	if (ret != 0) {
		goto out;
	}

	ret = compute_hmac_sha256(
		key_id,
		phase6_p2c_label,
		sizeof(phase6_p2c_label) - 1U,
		traffic_keys->peripheral_to_central);

	if (ret != 0) {
		goto out;
	}

	ret = 0;

out:
	if (key_id != 0) {
		(void)psa_destroy_key(key_id);
	}

	if (ret != 0) {
		pq_phase6_clear_traffic_keys(traffic_keys);
	}

	return ret;
}


int pq_phase6_encode_frame(
	uint8_t subtype,
	const uint8_t *payload,
	size_t payload_len,
	uint8_t *output,
	size_t output_capacity,
	size_t *output_len)
{
	static const uint8_t magic[] = PQ_PHASE6_FRAME_MAGIC;

	if (output == NULL ||
	    output_len == NULL ||
	    payload_len > UINT16_MAX ||
	    (payload_len > 0U && payload == NULL)) {
		return -EINVAL;
	}

	if (output_capacity <
	    PQ_PHASE6_FRAME_HEADER_SIZE + payload_len) {
		return -ENOBUFS;
	}

	memcpy(
		output,
		magic,
		PQ_PHASE6_FRAME_MAGIC_SIZE);

	output[4] = PQ_PHASE6_FRAME_VERSION;
	output[5] = subtype;
	output[6] = (uint8_t)(payload_len >> 8);
	output[7] = (uint8_t)payload_len;

	if (payload_len > 0U) {
		memcpy(
			output + PQ_PHASE6_FRAME_HEADER_SIZE,
			payload,
			payload_len);
	}

	*output_len =
		PQ_PHASE6_FRAME_HEADER_SIZE + payload_len;

	return 0;
}


int pq_phase6_parse_frame(
	const uint8_t *frame,
	size_t frame_len,
	uint8_t *subtype,
	const uint8_t **payload,
	size_t *payload_len)
{
	static const uint8_t magic[] = PQ_PHASE6_FRAME_MAGIC;
	size_t declared_len;

	if (frame == NULL ||
	    subtype == NULL ||
	    payload == NULL ||
	    payload_len == NULL ||
	    frame_len < PQ_PHASE6_FRAME_HEADER_SIZE) {
		return -EINVAL;
	}

	if (memcmp(
		    frame,
		    magic,
		    PQ_PHASE6_FRAME_MAGIC_SIZE) != 0 ||
	    frame[4] != PQ_PHASE6_FRAME_VERSION) {
		return -EINVAL;
	}

	declared_len =
		((size_t)frame[6] << 8) |
		frame[7];

	if (frame_len !=
	    PQ_PHASE6_FRAME_HEADER_SIZE + declared_len) {
		return -EINVAL;
	}

	*subtype = frame[5];
	*payload =
		frame + PQ_PHASE6_FRAME_HEADER_SIZE;
	*payload_len = declared_len;

	return 0;
}
```

## src/pq_phase6.h
```c
#ifndef PQ_PHASE6_H
#define PQ_PHASE6_H

#include <stddef.h>
#include <stdint.h>


#define PQ_PHASE6_TRAFFIC_KEY_SIZE 32U

#define PQ_PHASE6_FRAME_MAGIC "PQS6"
#define PQ_PHASE6_FRAME_MAGIC_SIZE 4U
#define PQ_PHASE6_FRAME_VERSION 0x06U
#define PQ_PHASE6_FRAME_HEADER_SIZE 8U

#define PQ_PHASE6_C2P_ACK 0x01U
#define PQ_PHASE6_ERROR   0x7fU

#define PQ_PHASE6_ACK_FRAME_SIZE \
	PQ_PHASE6_FRAME_HEADER_SIZE

#define PQ_PHASE6_ERROR_FRAME_SIZE \
	(PQ_PHASE6_FRAME_HEADER_SIZE + 1U)


/*
 * Phase 6 treats the authenticated v0.5 K_app as an application root key.
 *
 * It derives two independent direction-specific AES-256 traffic keys:
 *
 * K_c2p = HMAC-SHA256(
 *     K_app,
 *     "PQ-BLE-TRAFFIC-v0.6/CENTRAL-TO-PERIPHERAL"
 * )
 *
 * K_p2c = HMAC-SHA256(
 *     K_app,
 *     "PQ-BLE-TRAFFIC-v0.6/PERIPHERAL-TO-CENTRAL"
 * )
 *
 * K_app itself is not intended to encrypt Phase 6 application data.
 */
struct pq_phase6_traffic_keys {
	uint8_t central_to_peripheral[PQ_PHASE6_TRAFFIC_KEY_SIZE];
	uint8_t peripheral_to_central[PQ_PHASE6_TRAFFIC_KEY_SIZE];
};


/*
 * Derive the two directional traffic keys from the v0.5 application key.
 *
 * Returns:
 *   0        success
 *   -EINVAL  invalid argument
 *   -EIO     PSA Crypto failure
 *
 * On failure, traffic_keys is cleared.
 */
int pq_phase6_derive_traffic_keys(
	const uint8_t application_root_key[PQ_PHASE6_TRAFFIC_KEY_SIZE],
	struct pq_phase6_traffic_keys *traffic_keys);


/*
 * Securely clear both Phase 6 traffic keys.
 */
void pq_phase6_clear_traffic_keys(
	struct pq_phase6_traffic_keys *traffic_keys);


/*
 * Versioned Phase 6 control/status frame:
 *
 * "PQS6"(4)
 * || version=0x06(1)
 * || subtype(1)
 * || payload_len_be16(2)
 * || payload
 */
int pq_phase6_encode_frame(
	uint8_t subtype,
	const uint8_t *payload,
	size_t payload_len,
	uint8_t *output,
	size_t output_capacity,
	size_t *output_len);


int pq_phase6_parse_frame(
	const uint8_t *frame,
	size_t frame_len,
	uint8_t *subtype,
	const uint8_t **payload,
	size_t *payload_len);


#endif /* PQ_PHASE6_H */
```

## src/pq_phase7.h
```c
/* Hybrid ML-KEM-768/P-256 primitives for protocol version 0.7. */

#ifndef PQ_PHASE7_H_
#define PQ_PHASE7_H_

#include <stddef.h>
#include <stdint.h>
#include <stdbool.h>

#include <psa/crypto.h>
#include "pq_profile.h"

#define PQ_PHASE7_SESSION_ID_SIZE 16U
#define PQ_PHASE7_MLKEM_PUBLIC_KEY_SIZE 1184U
#define PQ_PHASE7_MLKEM_CIPHERTEXT_SIZE 1088U
#define PQ_PHASE7_P256_PRIVATE_KEY_SIZE 32U
#define PQ_PHASE7_P256_PUBLIC_KEY_SIZE 65U
#define PQ_PHASE7_SHARED_SECRET_SIZE 32U
#define PQ_PHASE7_HYBRID_IKM_SIZE 68U
#define PQ_PHASE7_TRANSCRIPT_SIZE 2457U
#define PQ_PHASE7_HASH_SIZE 32U
#define PQ_PHASE7_KEY_SIZE 32U
#define PQ_PHASE7_KEY_BLOCK_SIZE (4U * PQ_PHASE7_KEY_SIZE)
#define PQ_PHASE7_FINISHED_SIZE 32U

/* PQS7 wire framing shared by CP2 and CP3. */
#define PQ_PHASE7_FRAME_MAGIC "PQS7"
#define PQ_PHASE7_FRAME_MAGIC_SIZE 4U
#define PQ_PHASE7_FRAME_VERSION PQ_HYBRID_VERSION
#define PQ_PHASE7_FRAME_HEADER_SIZE 8U

/* CP2 interoperability-only subtypes. */
#define PQ_PHASE7_START7 0x01U
#define PQ_PHASE7_READY7_CP2 0x02U

/* CP3 authenticated-hybrid subtypes. */
#define PQ_PHASE7_START7_AUTH 0x03U
#define PQ_PHASE7_READY7_AUTH 0x04U
#define PQ_PHASE7_FINISHED_C 0x05U
#define PQ_PHASE7_FINISHED_P 0x06U

#define PQ_PHASE7_ERROR 0x7fU

/* CP2 diagnostic. */
#define PQ_PHASE7_CP2_DIAGNOSTIC_LABEL \
	"PQ-BLE-HANDSHAKE-v0.7/CP2-DIAGNOSTIC"

#define PQ_PHASE7_CP2_DIAGNOSTIC_SIZE 32U

/*
 * CP2 START7:
 * session_id(16) || Central P-256 public key(65)
 */
#define PQ_PHASE7_START7_PAYLOAD_SIZE 81U
#define PQ_PHASE7_START7_FRAME_SIZE \
	(PQ_PHASE7_FRAME_HEADER_SIZE + \
	 PQ_PHASE7_START7_PAYLOAD_SIZE)

/*
 * CP2 READY7_CP2:
 * Peripheral P-256 public key(65) || diagnostic(32)
 */
#define PQ_PHASE7_READY7_CP2_PAYLOAD_SIZE 97U
#define PQ_PHASE7_READY7_CP2_FRAME_SIZE \
	(PQ_PHASE7_FRAME_HEADER_SIZE + \
	 PQ_PHASE7_READY7_CP2_PAYLOAD_SIZE)

/*
 * CP3 START7_AUTH has the same payload shape as CP2 START7,
 * but a distinct subtype.
 */
#define PQ_PHASE7_START7_AUTH_PAYLOAD_SIZE \
	PQ_PHASE7_START7_PAYLOAD_SIZE

#define PQ_PHASE7_START7_AUTH_FRAME_SIZE \
	(PQ_PHASE7_FRAME_HEADER_SIZE + \
	 PQ_PHASE7_START7_AUTH_PAYLOAD_SIZE)

/*
 * CP3 READY7_AUTH:
 * Peripheral P-256 public key(65)
 */
#define PQ_PHASE7_READY7_AUTH_PAYLOAD_SIZE \
	PQ_PHASE7_P256_PUBLIC_KEY_SIZE

#define PQ_PHASE7_READY7_AUTH_FRAME_SIZE \
	(PQ_PHASE7_FRAME_HEADER_SIZE + \
	 PQ_PHASE7_READY7_AUTH_PAYLOAD_SIZE)

/*
 * CP3 FINISHED_C / FINISHED_P:
 * full HMAC-SHA256(32)
 */
#define PQ_PHASE7_FINISHED_PAYLOAD_SIZE \
	PQ_PHASE7_FINISHED_SIZE

#define PQ_PHASE7_FINISHED_FRAME_SIZE \
	(PQ_PHASE7_FRAME_HEADER_SIZE + \
	 PQ_PHASE7_FINISHED_PAYLOAD_SIZE)

/* PQS7 ERROR: status(1). */
#define PQ_PHASE7_ERROR_FRAME_SIZE \
	(PQ_PHASE7_FRAME_HEADER_SIZE + 1U)

/* Structural checks only; the worker must validate peer points with PSA. */
int pq_phase7_parse_frame(
	const uint8_t *frame, size_t frame_len, uint8_t *subtype,
	const uint8_t **payload, size_t *payload_len);
int pq_phase7_encode_frame(
	uint8_t subtype, const uint8_t *payload, size_t payload_len,
	uint8_t *output, size_t output_capacity, size_t *output_len);

/* Full TEST-ONLY HMAC(K_app, frozen CP2 label || transcript_hash). */
int pq_phase7_compute_cp2_diagnostic(
	const uint8_t *application_key, size_t application_key_len,
	const uint8_t *transcript_hash, size_t transcript_hash_len,
	uint8_t diagnostic[PQ_PHASE7_CP2_DIAGNOSTIC_SIZE]);

struct pq_phase7_keys {
	uint8_t application[PQ_PHASE7_KEY_SIZE];
	uint8_t sas[PQ_PHASE7_KEY_SIZE];
	uint8_t finished_c[PQ_PHASE7_KEY_SIZE];
	uint8_t finished_p[PQ_PHASE7_KEY_SIZE];
};

struct pq_phase7_traffic_keys {
	uint8_t central_to_peripheral[PQ_PHASE7_KEY_SIZE];
	uint8_t peripheral_to_central[PQ_PHASE7_KEY_SIZE];
};

/* Generate a non-exportable, volatile PSA P-256 keypair for ECDH. */
int pq_phase7_generate_p256_keypair(psa_key_id_t *key_id);

/* Export and verify the exact 65-byte SEC1 uncompressed public key. */
int pq_phase7_export_p256_public_key(
	psa_key_id_t key_id,
	uint8_t *public_key,
	size_t public_key_capacity,
	size_t *public_key_len);

/* Validate a peer SEC1 point, including PSA curve-point validation. */
int pq_phase7_validate_p256_public_key(
	const uint8_t *public_key,
	size_t public_key_len);

/* Derive the raw 32-byte ECDH secret from a volatile PSA private key. */
int pq_phase7_p256_ecdh(
	psa_key_id_t private_key_id,
	const uint8_t *peer_public_key,
	size_t peer_public_key_len,
	uint8_t *shared_secret,
	size_t shared_secret_capacity,
	size_t *shared_secret_len);

/* Destroy a volatile P-256 private key and clear its caller-held key ID. */
int pq_phase7_destroy_p256_key(psa_key_id_t *key_id);

/* Incremental SHA-256 over the eight canonical length-prefixed fields. */
int pq_phase7_transcript_hash(
	const uint8_t *session_id,
	size_t session_id_len,
	const uint8_t *mlkem_public_key,
	size_t mlkem_public_key_len,
	const uint8_t *mlkem_ciphertext,
	size_t mlkem_ciphertext_len,
	const uint8_t *central_p256_public_key,
	size_t central_p256_public_key_len,
	const uint8_t *peripheral_p256_public_key,
	size_t peripheral_p256_public_key_len,
	uint8_t transcript_hash[PQ_PHASE7_HASH_SIZE],
	size_t *canonical_transcript_len);

/* Construct u16be(32)||SS_MLKEM||u16be(32)||SS_ECDH. */
int pq_phase7_build_hybrid_ikm(
	const uint8_t *ss_mlkem,
	size_t ss_mlkem_len,
	const uint8_t *ss_ecdh,
	size_t ss_ecdh_len,
	uint8_t *hybrid_ikm,
	size_t hybrid_ikm_capacity,
	size_t *hybrid_ikm_len);

/*
 * Derive the v0.7 128-byte key block and split it into four keys.
 * This function always securely clears the caller's hybrid_ikm buffer.
 */
int pq_phase7_derive_keys(
	uint8_t hybrid_ikm[PQ_PHASE7_HYBRID_IKM_SIZE],
	size_t hybrid_ikm_len,
	const uint8_t *transcript_hash,
	size_t transcript_hash_len,
	struct pq_phase7_keys *keys);

int pq_phase7_compute_sas(
	const uint8_t *sas_key,
	size_t sas_key_len,
	const uint8_t *transcript_hash,
	size_t transcript_hash_len,
	uint32_t *sas);

int pq_phase7_compute_finished_c(
	const uint8_t *finished_key,
	size_t finished_key_len,
	const uint8_t *transcript_hash,
	size_t transcript_hash_len,
	uint8_t finished[PQ_PHASE7_FINISHED_SIZE]);

int pq_phase7_compute_finished_p(
	const uint8_t *finished_key,
	size_t finished_key_len,
	const uint8_t *transcript_hash,
	size_t transcript_hash_len,
	uint8_t finished[PQ_PHASE7_FINISHED_SIZE]);

bool pq_phase7_finished_equal(
	const uint8_t left[PQ_PHASE7_FINISHED_SIZE],
	const uint8_t right[PQ_PHASE7_FINISHED_SIZE]);

int pq_phase7_derive_traffic_keys(
	const uint8_t *application_root_key,
	size_t application_root_key_len,
	struct pq_phase7_traffic_keys *traffic_keys);

void pq_phase7_clear(void *buffer, size_t len);
void pq_phase7_clear_keys(struct pq_phase7_keys *keys);
void pq_phase7_clear_traffic_keys(struct pq_phase7_traffic_keys *keys);

/* Run the production-random P-256 check and the public hybrid KAT. */
int pq_phase7_self_test(void);

#endif /* PQ_PHASE7_H_ */
```

## src/pq_profile.h
```c
#ifndef PQ_PROFILE_H_
#define PQ_PROFILE_H_
/* Only explicit new Kconfig choices change wire identities or domains. */
#if defined(CONFIG_PQ_PROFILE_V08_RESUME_HYBRID)
#define PQ_APP_VERSION 0x08U
#define PQ_APP_DOMAIN "PQ-BLE-HANDSHAKE-v0.8"
#define PQ_HYBRID_DOMAIN "PQ-BLE-HANDSHAKE-v0.8"
#define PQ_HYBRID_TRAFFIC_DOMAIN "PQ-BLE-TRAFFIC-v0.8"
#define PQ_HYBRID_VERSION 0x08U
#elif defined(CONFIG_PQ_PROFILE_V11_SMP_L4_MLKEM_RESUME)
#define PQ_APP_VERSION 0x11U
#define PQ_APP_DOMAIN "PQ-BLE-HANDSHAKE-v1.1"
#endif
#ifndef PQ_APP_VERSION
#define PQ_APP_VERSION 0x10U
#define PQ_APP_DOMAIN "PQ-BLE-HANDSHAKE-v1.0"
#endif
#ifndef PQ_HYBRID_DOMAIN
#define PQ_HYBRID_DOMAIN "PQ-BLE-HANDSHAKE-v0.7"
#define PQ_HYBRID_TRAFFIC_DOMAIN "PQ-BLE-TRAFFIC-v0.7"
#define PQ_HYBRID_VERSION 0x07U
#endif
#endif
```
