## CMakeLists.txt
```
# nRF54L15 DK — nRF Connect SDK / Zephyr project
#
# Build:
#   west build -b nrf54l15dk/nrf54l15/cpuapp -p always

cmake_minimum_required(VERSION 3.20.0)
find_package(ZEPHYR REQUIRED HINTS $ENV{ZEPHYR_BASE})

project(pq_ble_gatt_skeleton)

target_sources(app PRIVATE
    src/main.c
)
```

## prj.conf
```kconfig
# Bluetooth core
CONFIG_BT=y
CONFIG_BT_PERIPHERAL=y
CONFIG_BT_DEVICE_NAME="PQ-BLE-Device"
CONFIG_BT_DEVICE_APPEARANCE=0

# No BLE Security Manager pairing.
# PQ-BLE provides security at application layer.
CONFIG_BT_SMP=n

# GATT / ATT
CONFIG_BT_ATT_PREPARE_COUNT=4
CONFIG_BT_L2CAP_TX_MTU=517

# Buffers
CONFIG_BT_BUF_ACL_RX_SIZE=251
CONFIG_BT_BUF_ACL_TX_SIZE=251
CONFIG_BT_BUF_ACL_RX_COUNT=10
CONFIG_BT_BUF_ACL_TX_COUNT=10

# Stack sizes
CONFIG_MAIN_STACK_SIZE=4096
CONFIG_SYSTEM_WORKQUEUE_STACK_SIZE=4096

# Logging
CONFIG_LOG=y
CONFIG_LOG_DEFAULT_LEVEL=3
```

## src/main.c
```c
/*
 * PQ-BLE Handshake — nRF54L15 DK Firmware
 * ========================================
 *
 * GATT Peripheral for the PQ-BLE-HANDSHAKE protocol.
 *
 * MODE: DEMO_PRECOMPUTED_KEM
 *   The DK does NOT execute ML-KEM on-chip (that is future work).
 *   Instead, a precomputed ML-KEM-768 public key is hardcoded.
 *   The PC (Central) reads the public key, computes the ciphertext
 *   in Python, and writes it back. The DK validates the length,
 *   optionally compares with an expected ciphertext, and sends a
 *   precomputed AES-256-GCM encrypted payload via GATT Notify
 *   when it receives a START command on the Control characteristic.
 *
 * Hardware:  nRF54L15 DK (PCA10155)
 * Board:     nrf54l15dk/nrf54l15/cpuapp
 * SDK:       nRF Connect SDK >= 2.8.0 (Zephyr)
 *
 * Build:
 *   west build -b nrf54l15dk/nrf54l15/cpuapp -p always
 *   west flash
 *
 * GATT Service: 12345678-1234-1234-1234-123456789abc
 *   Public Key  (READ):    ...9abd  — ML-KEM-768 pk (1184 B, precomputed)
 *   Ciphertext  (WRITE):   ...9abe  — ML-KEM-768 ct (1088 B, fragmented)
 *   Secure Data (NOTIFY):  ...9abf  — AES-256-GCM encrypted payload
 *   Control     (WRITE):   ...9ac0  — START / SAS-confirm / resume
 *
 * Honesty note:
 *   This firmware validates the GATT transport layer only.
 *   Full embedded ML-KEM execution on nRF54L15 is FUTURE WORK.
 */

#include <zephyr/kernel.h>
#include <zephyr/bluetooth/bluetooth.h>
#include <zephyr/bluetooth/conn.h>
#include <zephyr/bluetooth/gatt.h>
#include <zephyr/bluetooth/uuid.h>
#include <zephyr/logging/log.h>
#include <string.h>

LOG_MODULE_REGISTER(pq_ble, LOG_LEVEL_INF);

/* ── Device name ── */
#define DEVICE_NAME         "PQ-BLE-Device"
#define DEVICE_NAME_LEN     (sizeof(DEVICE_NAME) - 1)

/* ── Custom 128-bit UUIDs (match Python src/common/constants.py) ──
 *
 * BT_UUID_128_ENCODE(w32, w16_1, w16_2, w16_3, w48)
 * UUID: 12345678-1234-1234-1234-123456789abc
 */
#define PQ_SERVICE_UUID \
    BT_UUID_128_ENCODE(0x12345678, 0x1234, 0x1234, 0x1234, 0x123456789abc)

#define PQ_CHAR_PUBKEY_UUID \
    BT_UUID_128_ENCODE(0x12345678, 0x1234, 0x1234, 0x1234, 0x123456789abd)

#define PQ_CHAR_CIPHERTEXT_UUID \
    BT_UUID_128_ENCODE(0x12345678, 0x1234, 0x1234, 0x1234, 0x123456789abe)

#define PQ_CHAR_DATA_UUID \
    BT_UUID_128_ENCODE(0x12345678, 0x1234, 0x1234, 0x1234, 0x123456789abf)

#define PQ_CHAR_CONTROL_UUID \
    BT_UUID_128_ENCODE(0x12345678, 0x1234, 0x1234, 0x1234, 0x123456789ac0)

/* ── Protocol constants (match Python constants.py) ── */
#define ML_KEM_PK_SIZE       1184
#define ML_KEM_CT_SIZE       1088
#define FRAG_HEADER_SIZE     4     /* idx(1) + total(1) + len(2 BE) */
#define MAX_FRAGMENTS        8     /* 1184 B / 508 B ≈ 3 fragments */
#define MAX_FRAG_PAYLOAD     512

/* Control commands (ASCII, match Python parse_control_message) */
#define CTRL_START           "START"
#define CTRL_START_LEN       5
#define CTRL_SAS_OK          "OK"
#define CTRL_SAS_OK_LEN      2
#define RESUME_MAGIC         "PQBL"
#define RESUME_MAGIC_LEN     4
#define RESUME_REQ_BYTE      0x01

/*
 * Valid ML-KEM-768 public key generated offline.
 *
 * The corresponding secret key is intentionally not stored because the
 * current firmware validates only the BLE/GATT transport path and does
 * not perform ML-KEM decapsulation on-chip.
 */
#include "demo_public_key.h"

_Static_assert(
    sizeof(demo_pk) == ML_KEM_PK_SIZE,
    "Invalid demo ML-KEM public-key size"
);

/* Precomputed/demo notification payload.
 * Format: seq(8) || msg_type(1) || iv(12) || ciphertext || tag(16)
 * Current placeholder length: 57 bytes = 8 + 1 + 12 + 20 + 16.
 *
 * In the current hardware demo, this payload is used only to validate
 * GATT notification transport. It is not encrypted with the session key
 * derived by the PC central because the DK does not perform on-chip
 * ML-KEM decapsulation/HKDF/AES-GCM yet.
 */
static uint8_t demo_notify_payload[] = {
    /* Placeholder — replace with real encrypted payload */
    0x00, 0x00, 0x00, 0x00, 0x00, 0x00, 0x00, 0x00,  /* seq */
    0x01,                                              /* msg_type = DATA */
    0x00, 0x00, 0x00, 0x00, 0x00, 0x00, 0x00, 0x00,  /* iv */
    0x00, 0x00, 0x00, 0x00,                            /* iv cont */
    /* ciphertext placeholder — "Hello from nRF54L15!" (20 bytes) */
    0x00, 0x00, 0x00, 0x00, 0x00, 0x00, 0x00, 0x00,
    0x00, 0x00, 0x00, 0x00, 0x00, 0x00, 0x00, 0x00,
    0x00, 0x00, 0x00, 0x00,
    /* tag placeholder (16 bytes) */
    0x00, 0x00, 0x00, 0x00, 0x00, 0x00, 0x00, 0x00,
    0x00, 0x00, 0x00, 0x00, 0x00, 0x00, 0x00, 0x00,
};

/* Expected ciphertext (optional validation — set to all-zero to skip) */
static uint8_t expected_ct[ML_KEM_CT_SIZE];  /* zero-initialized = skip */

/* ── Buffers ── */
static uint8_t ct_buffer[ML_KEM_CT_SIZE];
static uint8_t ct_fragments[MAX_FRAGMENTS][MAX_FRAG_PAYLOAD + FRAG_HEADER_SIZE];
static uint8_t ct_frag_received[MAX_FRAGMENTS];
static uint8_t ct_frag_total = 0;
static uint16_t ct_frag_lens[MAX_FRAGMENTS];
static bool ct_ready = false;
static bool notify_enabled = false;

/* ── Connection ── */
static struct bt_conn *current_conn = NULL;

/* ── Forward declarations ── */
static ssize_t read_public_key(struct bt_conn *conn,
                               const struct bt_gatt_attr *attr,
                               void *buf, uint16_t len, uint16_t offset);
static ssize_t write_ciphertext(struct bt_conn *conn,
                                const struct bt_gatt_attr *attr,
                                const void *buf, uint16_t len,
                                uint16_t offset, uint8_t flags);
static ssize_t write_control(struct bt_conn *conn,
                             const struct bt_gatt_attr *attr,
                             const void *buf, uint16_t len,
                             uint16_t offset, uint8_t flags);
static void ccc_config_changed(const struct bt_gatt_attr *attr,
                               uint16_t value);
static void send_demo_notify(void);

/* ── Advertising data ── */
static const struct bt_data ad[] = {
    BT_DATA_BYTES(BT_DATA_FLAGS, (BT_LE_AD_GENERAL | BT_LE_AD_NO_BREDR)),
    BT_DATA(BT_DATA_NAME_COMPLETE, DEVICE_NAME, DEVICE_NAME_LEN),
};

/* ── GATT Service Definition ──
 *
 * Attribute index reference (0-based within pq_service):
 *   [0] Primary Service declaration
 *   [1] Public Key characteristic declaration
 *   [2] Public Key characteristic value
 *   [3] Ciphertext characteristic declaration
 *   [4] Ciphertext characteristic value
 *   [5] Data characteristic declaration
 *   [6] Data characteristic value
 *   [7] CCCD for Data notifications
 *   [8] Control characteristic declaration
 *   [9] Control characteristic value
 */
BT_GATT_SERVICE_DEFINE(
    pq_service,

    BT_GATT_PRIMARY_SERVICE(BT_UUID_DECLARE_128(PQ_SERVICE_UUID)),

    /* Public Key — READ */
    BT_GATT_CHARACTERISTIC(
        BT_UUID_DECLARE_128(PQ_CHAR_PUBKEY_UUID),
        BT_GATT_CHRC_READ,
        BT_GATT_PERM_READ,
        read_public_key, NULL, NULL
    ),

    /* Ciphertext — WRITE (with response) */
    BT_GATT_CHARACTERISTIC(
        BT_UUID_DECLARE_128(PQ_CHAR_CIPHERTEXT_UUID),
        BT_GATT_CHRC_WRITE,
        BT_GATT_PERM_WRITE,
        NULL, write_ciphertext, NULL
    ),

    /* Secure Data — NOTIFY */
    BT_GATT_CHARACTERISTIC(
        BT_UUID_DECLARE_128(PQ_CHAR_DATA_UUID),
        BT_GATT_CHRC_NOTIFY,
        BT_GATT_PERM_NONE,
        NULL, NULL, NULL
    ),
    /* CCCD for notifications */
    BT_GATT_CCC(ccc_config_changed,
                BT_GATT_PERM_READ | BT_GATT_PERM_WRITE),

    /* Control — WRITE */
    BT_GATT_CHARACTERISTIC(
        BT_UUID_DECLARE_128(PQ_CHAR_CONTROL_UUID),
        BT_GATT_CHRC_WRITE,
        BT_GATT_PERM_WRITE,
        NULL, write_control, NULL
    ),
);

/* ── GATT Callbacks ── */

static ssize_t read_public_key(struct bt_conn *conn,
                               const struct bt_gatt_attr *attr,
                               void *buf, uint16_t len, uint16_t offset)
{
    LOG_INF("PK read: offset=%u, len=%u", offset, len);
    return bt_gatt_attr_read(conn, attr, buf, len, offset,
                             demo_pk, sizeof(demo_pk));
}

static ssize_t write_ciphertext(struct bt_conn *conn,
                                const struct bt_gatt_attr *attr,
                                const void *buf, uint16_t len,
                                uint16_t offset, uint8_t flags)
{
    LOG_INF("CT write: offset=%u, len=%u", offset, len);

    if (len < FRAG_HEADER_SIZE) {
        LOG_ERR("CT fragment too short: %u < %u", len, FRAG_HEADER_SIZE);
        return BT_GATT_ERR(BT_ATT_ERR_INVALID_ATTRIBUTE_LEN);
    }

    /* Parse fragment header: [idx:1][total:1][payload_len:2 BE] */
    const uint8_t *data = (const uint8_t *)buf;
    uint8_t idx = data[0];
    uint8_t total = data[1];
    uint16_t payload_len = (data[2] << 8) | data[3];

    /* Validate */
    if (idx >= MAX_FRAGMENTS || total > MAX_FRAGMENTS || total == 0) {
        LOG_ERR("CT fragment idx/total invalid: idx=%u total=%u",
                idx, total);
        return BT_GATT_ERR(BT_ATT_ERR_INVALID_ATTRIBUTE_LEN);
    }

    if (payload_len != (len - FRAG_HEADER_SIZE)) {
        LOG_ERR("CT payload_len mismatch: header=%u, actual=%u",
                payload_len, len - FRAG_HEADER_SIZE);
        return BT_GATT_ERR(BT_ATT_ERR_INVALID_ATTRIBUTE_LEN);
    }

    if (payload_len > MAX_FRAG_PAYLOAD) {
        LOG_ERR("CT payload too large: %u > %u", payload_len, MAX_FRAG_PAYLOAD);
        return BT_GATT_ERR(BT_ATT_ERR_INVALID_ATTRIBUTE_LEN);
    }

    /* Store fragment */
    ct_frag_total = total;
    ct_frag_received[idx] = 1;
    ct_frag_lens[idx] = payload_len;
    memcpy(ct_fragments[idx], data + FRAG_HEADER_SIZE, payload_len);

    LOG_INF("CT fragment %u/%u stored (%u bytes payload)",
            idx + 1, ct_frag_total, payload_len);

    /* Check if all fragments received */
    bool all_received = true;
    for (int i = 0; i < ct_frag_total; i++) {
        if (!ct_frag_received[i]) {
            all_received = false;
            break;
        }
    }

    if (all_received && ct_frag_total > 0) {
        /* Reassemble into ct_buffer */
        uint16_t offset_ct = 0;
        for (int i = 0; i < ct_frag_total; i++) {
            if (offset_ct + ct_frag_lens[i] > ML_KEM_CT_SIZE) {
                LOG_ERR("CT reassembly overflow: %u > %u",
                        offset_ct + ct_frag_lens[i], ML_KEM_CT_SIZE);
                return BT_GATT_ERR(BT_ATT_ERR_INVALID_ATTRIBUTE_LEN);
            }
            memcpy(ct_buffer + offset_ct, ct_fragments[i], ct_frag_lens[i]);
            offset_ct += ct_frag_lens[i];
        }

        ct_ready = true;
        LOG_INF("✅ All %u CT fragments reassembled: %u bytes",
                ct_frag_total, offset_ct);

        /* Optional: validate against expected_ct */
        bool has_expected = false;
        for (int i = 0; i < ML_KEM_CT_SIZE; i++) {
            if (expected_ct[i] != 0) {
                has_expected = true;
                break;
            }
        }
        if (has_expected) {
            if (memcmp(ct_buffer, expected_ct, ML_KEM_CT_SIZE) == 0) {
                LOG_INF("CT matches expected ciphertext ✓");
            } else {
                LOG_WRN("CT does NOT match expected ciphertext");
            }
        }
    }

    return len;
}

static ssize_t write_control(struct bt_conn *conn,
                             const struct bt_gatt_attr *attr,
                             const void *buf, uint16_t len,
                             uint16_t offset, uint8_t flags)
{
    const uint8_t *data = (const uint8_t *)buf;

    LOG_INF("Control write: len=%u", len);
    LOG_HEXDUMP_INF(data, len, "Control data");

    /* START command — trigger demo notify */
    if (len == CTRL_START_LEN && memcmp(data, CTRL_START, CTRL_START_LEN) == 0) {
        LOG_INF("Received START command");
        if (!ct_ready) {
            LOG_WRN("START received but ciphertext not yet written");
            return len;
        }
        if (!notify_enabled) {
            LOG_WRN("START received but notifications not enabled (CCCD)");
            return len;
        }
        send_demo_notify();
        return len;
    }

    /* SAS confirmation "OK" */
    if (len == CTRL_SAS_OK_LEN && memcmp(data, CTRL_SAS_OK, CTRL_SAS_OK_LEN) == 0) {
        LOG_INF("SAS confirmation received");
        return len;
    }

    /* Resume request: PQBL (4) + 0x01 (1) + session_id (16) = 21 bytes */
    if (len == (RESUME_MAGIC_LEN + 1 + 16) &&
        memcmp(data, RESUME_MAGIC, RESUME_MAGIC_LEN) == 0 &&
        data[RESUME_MAGIC_LEN] == RESUME_REQ_BYTE) {
        LOG_INF("Resume request received (session_id in payload)");
        /* TODO: look up session_id in persistent store.
         * For now, just log it. Full resume support requires
         * flash storage on the DK. */
        return len;
    }

    LOG_WRN("Unknown control message");
    return len;
}

static void ccc_config_changed(const struct bt_gatt_attr *attr,
                               uint16_t value)
{
    notify_enabled = (value == BT_GATT_CCC_NOTIFY);
    LOG_INF("Notifications %s", notify_enabled ? "ENABLED" : "DISABLED");
}

/* ── Send precomputed demo notification ── */
static void send_demo_notify(void)
{
    if (!current_conn) {
        LOG_ERR("Cannot notify: no active connection");
        return;
    }
    if (!notify_enabled) {
        LOG_ERR("Cannot notify: CCCD not enabled");
        return;
    }

    /* Notify on the Data characteristic (attribute index 6 in pq_service).
     * BT_GATT_SERVICE_DEFINE puts the characteristic value at a known
     * offset. We use &pq_service.attrs[6] for the Data characteristic
     * value attribute.
     *
     * NOTE: The exact index depends on the service definition order.
     *       Verify with bt_gatt_attr_get_uuid() if uncertain. */
    int err = bt_gatt_notify(current_conn, &pq_service.attrs[6],
                             demo_notify_payload,
                             sizeof(demo_notify_payload));
    if (err) {
        LOG_ERR("bt_gatt_notify failed: %d", err);
    } else {
        LOG_INF("✅ Demo notification sent: %u bytes",
                sizeof(demo_notify_payload));
    }
}

/* ── Connection callbacks ── */

static void connected(struct bt_conn *conn, uint8_t err)
{
    if (err) {
        LOG_ERR("Connection failed (err %u)", err);
        return;
    }
    current_conn = bt_conn_ref(conn);
    LOG_INF("Connected!");
}

static void disconnected(struct bt_conn *conn, uint8_t reason)
{
    LOG_INF("Disconnected (reason %u)", reason);
    if (current_conn) {
        bt_conn_unref(current_conn);
        current_conn = NULL;
    }

    /* Reset state for next connection */
    ct_frag_total = 0;
    ct_ready = false;
    notify_enabled = false;
    memset(ct_frag_received, 0, sizeof(ct_frag_received));
    memset(ct_frag_lens, 0, sizeof(ct_frag_lens));
    memset(ct_buffer, 0, sizeof(ct_buffer));
}

BT_CONN_CB_DEFINE(conn_callbacks) = {
    .connected = connected,
    .disconnected = disconnected,
};

/* ── MTU update callback ── */
static void mtu_updated(struct bt_conn *conn, uint16_t tx, uint16_t rx)
{
    LOG_INF("MTU updated: TX=%u, RX=%u", tx, rx);
}

static struct bt_gatt_cb gatt_callbacks = {
    .att_mtu_updated = mtu_updated,
};

/* ── Main ── */

void main(void)
{
    int err;

    LOG_INF("========================================");
    LOG_INF("PQ-BLE Handshake — nRF54L15 DK Peripheral");
    LOG_INF("Mode: VALID_MLKEM_PK_TRANSPORT_DEMO");
    LOG_INF("Device: %s", DEVICE_NAME);
    LOG_INF("========================================");

    /* Initialize Bluetooth */
    err = bt_enable(NULL);
    if (err) {
        LOG_ERR("bt_enable failed (err %d)", err);
        return;
    }
    LOG_INF("Bluetooth initialized.");

    bt_gatt_cb_register(&gatt_callbacks);

    /* Start advertising */
    err = bt_le_adv_start(BT_LE_ADV_CONN, ad, ARRAY_SIZE(ad), NULL, 0);
    if (err) {
        LOG_ERR("Advertising failed (err %d)", err);
        return;
    }

    LOG_INF("Advertising as '%s'. Waiting for Central...", DEVICE_NAME);
    LOG_INF("PK size: %d bytes, CT size: %d bytes",
            ML_KEM_PK_SIZE, ML_KEM_CT_SIZE);

    /* Main loop — restart advertising if disconnected */
    while (1) {
        k_sleep(K_SECONDS(1));
        if (!current_conn) {
            bt_le_adv_start(BT_LE_ADV_CONN, ad, ARRAY_SIZE(ad), NULL, 0);
        }
    }
}
```

## src/demo_public_key.h
```c
#ifndef PQ_BLE_DEMO_PUBLIC_KEY_H_
#define PQ_BLE_DEMO_PUBLIC_KEY_H_

/*
 * Generated by scripts/generate_firmware_public_key.py.
 *
 * This is a syntactically valid ML-KEM-768 public key.
 * SHA-256 fingerprint:
 * 660da9e73485e45ac35a3a6cd4d65fe39efe161bb01444893733c102566ee912
 *
 * The corresponding secret key is intentionally not stored.
 * Therefore, the current nRF54L15 firmware still validates only the
 * BLE/GATT transport path and cannot decapsulate the central ciphertext.
 */

static const uint8_t demo_pk[1184] = {
    0xA1, 0x27, 0xC5, 0x6A, 0x17, 0xAC, 0xD0, 0x91, 0x8D, 0x7E, 0xB8, 0xC7,
    0xC8, 0x53, 0xA5, 0x41, 0x8A, 0x4E, 0x34, 0x6A, 0x5C, 0xCE, 0x69, 0x58,
    0xB6, 0xBB, 0x28, 0x46, 0xB3, 0x7B, 0x24, 0xC9, 0x12, 0x9E, 0x83, 0xAB,
    0x48, 0x9A, 0x84, 0x1B, 0xF7, 0xC2, 0x75, 0x5B, 0x9B, 0x9D, 0x66, 0x5A,
    0xEE, 0x84, 0x2A, 0x32, 0x51, 0xA5, 0xC3, 0xCC, 0xC6, 0x0C, 0x88, 0x01,
    0x42, 0x80, 0x64, 0x56, 0x65, 0x3D, 0x59, 0xB3, 0x31, 0xBB, 0xE1, 0x30,
    0x95, 0xD7, 0xB5, 0x45, 0x32, 0x77, 0xBA, 0x75, 0x96, 0x18, 0x37, 0x0D,
    0xE3, 0xD9, 0x22, 0x74, 0xA3, 0x78, 0xEC, 0xB6, 0xB9, 0xDC, 0x72, 0x5D,
    0xA5, 0x57, 0xBB, 0xBC, 0xF2, 0x40, 0x91, 0xE3, 0x36, 0x56, 0xF4, 0x0D,
    0xA3, 0x74, 0xB3, 0xD9, 0x31, 0xB0, 0xF2, 0xE8, 0xAD, 0xFF, 0x7C, 0x07,
    0x77, 0x15, 0x13, 0xE9, 0x52, 0x90, 0x6B, 0xC2, 0x7A, 0x22, 0x10, 0x66,
    0x05, 0x16, 0x54, 0xFC, 0x20, 0x42, 0x30, 0xFC, 0x06, 0xDF, 0xE5, 0x64,
    0xC4, 0x02, 0x75, 0x53, 0xE1, 0xA2, 0xE4, 0x58, 0xC4, 0xA8, 0xD2, 0x09,
    0xC3, 0x09, 0x70, 0x05, 0xAC, 0x2E, 0x38, 0xF5, 0x05, 0x96, 0xCA, 0xB8,
    0x8C, 0x36, 0xB8, 0x71, 0xC4, 0x79, 0xD8, 0xB6, 0x43, 0x99, 0x05, 0x91,
    0xE5, 0x37, 0x36, 0xF9, 0xD6, 0x9F, 0xD4, 0xAC, 0x11, 0x7C, 0xFC, 0x37,
    0xE2, 0x8A, 0x6F, 0xF5, 0x2C, 0x76, 0xCE, 0x42, 0x8B, 0x1F, 0x0A, 0x35,
    0x20, 0x89, 0x63, 0x79, 0x94, 0xA2, 0x88, 0x53, 0xB6, 0x09, 0x8A, 0x58,
    0xD2, 0xEA, 0xCB, 0xDE, 0x09, 0xBE, 0xCC, 0x88, 0x39, 0x35, 0x66, 0x11,
    0x59, 0x8A, 0x21, 0x3D, 0x16, 0x9B, 0x63, 0x5C, 0xBC, 0x81, 0xEB, 0x4B,
    0xF8, 0x08, 0x48, 0x67, 0x8C, 0x68, 0xEC, 0xFA, 0xBC, 0xF6, 0x6B, 0xB9,
    0x1E, 0x18, 0x76, 0x52, 0x41, 0xC8, 0xF0, 0xA0, 0x80, 0x8F, 0x47, 0x9E,
    0xA6, 0xBB, 0x77, 0xB7, 0x21, 0x2A, 0x04, 0x32, 0xC3, 0xB3, 0x5B, 0xCB,
    0x14, 0xF6, 0xAF, 0x92, 0xA0, 0x25, 0x1C, 0xBC, 0xBD, 0xAA, 0x7A, 0xCF,
    0x1B, 0xB8, 0x0E, 0xD4, 0xD5, 0xB1, 0xCB, 0xE2, 0xC2, 0xD8, 0x3C, 0x1F,
    0xA2, 0x51, 0xAB, 0xF2, 0x07, 0x04, 0x3C, 0xE5, 0x26, 0x99, 0xBA, 0x94,
    0x2C, 0xF7, 0xB3, 0x54, 0xA9, 0xB9, 0xA6, 0xB9, 0x69, 0xBE, 0xD1, 0xC8,
    0x31, 0xD1, 0x1D, 0xF2, 0xE9, 0xAA, 0xB5, 0xC2, 0x33, 0xBC, 0x43, 0x88,
    0x95, 0x2B, 0xBF, 0xF3, 0x1B, 0x0B, 0x39, 0xC0, 0x0D, 0xB1, 0x3B, 0xAF,
    0xF0, 0xE0, 0x96, 0x28, 0x08, 0x33, 0xCD, 0xF1, 0x68, 0xB1, 0x23, 0x1D,
    0x42, 0x84, 0x4D, 0x35, 0xBB, 0x0E, 0xD4, 0xDC, 0x61, 0xAC, 0xB9, 0x8C,
    0x64, 0xF8, 0xA0, 0xF5, 0xA8, 0x33, 0x1E, 0x18, 0x64, 0xD7, 0xB3, 0xAD,
    0x3E, 0x10, 0x7B, 0x82, 0xA1, 0x22, 0xAA, 0x42, 0x98, 0x6D, 0x80, 0x1F,
    0x10, 0x40, 0x36, 0x0F, 0x29, 0x09, 0xAC, 0xAA, 0x6F, 0xD2, 0x3A, 0xA8,
    0x36, 0xE1, 0x87, 0x51, 0xEC, 0x84, 0x44, 0xCC, 0x9D, 0xCB, 0xA6, 0x80,
    0x19, 0x27, 0x2E, 0x12, 0xC4, 0x81, 0x56, 0x00, 0x20, 0xD0, 0x4B, 0x98,
    0xCB, 0xF1, 0x84, 0x32, 0xEC, 0xA6, 0x05, 0x03, 0x36, 0xB6, 0x56, 0x11,
    0xB6, 0x3A, 0x1F, 0x7E, 0x29, 0xAF, 0x4D, 0xE0, 0xA3, 0x74, 0x19, 0x1C,
    0x55, 0xE7, 0x9E, 0x72, 0xF9, 0x14, 0x2B, 0xE1, 0xCD, 0xE7, 0x7C, 0x55,
    0x85, 0x54, 0x79, 0x9C, 0x52, 0x37, 0x4B, 0x35, 0x12, 0xFD, 0x49, 0x51,
    0x95, 0x30, 0x9F, 0x86, 0x4A, 0x69, 0x33, 0xD6, 0x38, 0x94, 0x58, 0x09,
    0x07, 0x78, 0x13, 0x64, 0xA1, 0x61, 0xE8, 0x26, 0x5B, 0x56, 0x28, 0x6B,
    0x30, 0x37, 0x96, 0x65, 0xB9, 0xCA, 0x14, 0xE6, 0x86, 0x26, 0xBC, 0x06,
    0x1E, 0xCB, 0xCA, 0xC9, 0x90, 0x60, 0x04, 0x8C, 0x9B, 0xDE, 0xAA, 0x4F,
    0xD9, 0x03, 0x32, 0xBE, 0xE5, 0x07, 0x6F, 0xE9, 0x84, 0xB4, 0x73, 0x8C,
    0xF7, 0x9A, 0x46, 0x34, 0x26, 0x8A, 0x12, 0xA6, 0x04, 0xD7, 0x43, 0x3F,
    0x80, 0x38, 0x07, 0x99, 0xB5, 0x65, 0x6D, 0x52, 0x78, 0x47, 0xB0, 0x04,
    0x73, 0x23, 0xB5, 0x2A, 0xB6, 0x9C, 0x9D, 0x25, 0x0E, 0x27, 0xD9, 0x56,
    0xD2, 0x9A, 0xB0, 0xAB, 0x34, 0x16, 0xFD, 0xEB, 0x9A, 0xD7, 0xF4, 0x87,
    0x2A, 0x71, 0x79, 0x26, 0x36, 0x87, 0x09, 0x88, 0x21, 0xDB, 0xB3, 0x3E,
    0x6A, 0xA6, 0x2D, 0x6F, 0xA4, 0x88, 0xB1, 0x90, 0x11, 0x08, 0xA2, 0x42,
    0x97, 0xD2, 0x3A, 0x2F, 0x42, 0xB2, 0xB4, 0x17, 0x4B, 0x3C, 0x01, 0x9F,
    0x9E, 0xB2, 0xCF, 0x2F, 0x30, 0xA9, 0x0D, 0x33, 0x53, 0xE6, 0xE4, 0x54,
    0x13, 0xB4, 0x2B, 0x62, 0x83, 0x99, 0x52, 0x75, 0x5E, 0x5B, 0x7A, 0x58,
    0x54, 0x54, 0x4E, 0x86, 0x45, 0x16, 0xA0, 0xC4, 0x39, 0x9A, 0xB3, 0x9E,
    0xEB, 0x82, 0xCA, 0x70, 0x74, 0xB6, 0x91, 0x4A, 0x3A, 0x3F, 0x35, 0x2F,
    0xFC, 0x56, 0xCC, 0x0D, 0xDB, 0x8F, 0xE8, 0x4C, 0xAD, 0xA6, 0xEC, 0xB5,
    0x46, 0x19, 0x9E, 0x8D, 0xC6, 0x28, 0xB3, 0x00, 0x18, 0x44, 0x1B, 0x11,
    0x9F, 0x03, 0x9F, 0x12, 0x02, 0x7A, 0x66, 0x71, 0x1E, 0x4E, 0xB4, 0x58,
    0xE9, 0xB0, 0x86, 0xEA, 0xFC, 0xAE, 0x4B, 0xF1, 0x98, 0xD4, 0x01, 0x1B,
    0x14, 0x62, 0x40, 0x86, 0x4B, 0x1E, 0xD5, 0xD8, 0x1B, 0x84, 0x09, 0x8B,
    0x6C, 0x3C, 0xA1, 0xF2, 0x54, 0x67, 0x59, 0xA6, 0x4A, 0x78, 0xB0, 0xB5,
    0xE1, 0xC8, 0x9F, 0x13, 0x34, 0x68, 0xDC, 0x9C, 0xB9, 0x5D, 0x84, 0x83,
    0x35, 0xB0, 0x47, 0xBE, 0x51, 0x3E, 0xBE, 0xD2, 0x0A, 0xDC, 0x82, 0xB9,
    0xD6, 0xB8, 0xA9, 0xFA, 0x6A, 0x78, 0x38, 0xE8, 0xA6, 0x5D, 0xE7, 0x5F,
    0x2D, 0x89, 0x9F, 0x1C, 0x25, 0x04, 0x90, 0x01, 0x3C, 0x43, 0xD9, 0x31,
    0x9A, 0xFA, 0xBC, 0x5A, 0x65, 0x25, 0x5C, 0x81, 0xAD, 0xD6, 0x92, 0x89,
    0xF3, 0xA3, 0x71, 0xAD, 0x54, 0x3C, 0x32, 0x54, 0x73, 0x7B, 0x82, 0xCF,
    0x33, 0xC2, 0x8B, 0x25, 0x28, 0x8E, 0x32, 0x25, 0x01, 0xB8, 0x9B, 0x81,
    0x2D, 0xE6, 0x14, 0x54, 0xE6, 0x3A, 0x5D, 0xE2, 0x83, 0x84, 0xC9, 0x07,
    0xCF, 0xF7, 0x71, 0x42, 0x1B, 0x2B, 0x1F, 0x25, 0xBE, 0xD9, 0x7B, 0x11,
    0x5B, 0xB5, 0xB2, 0x2E, 0xF1, 0xBE, 0x1F, 0x43, 0xCB, 0x16, 0x6A, 0x77,
    0xE7, 0xB1, 0x47, 0x35, 0x7C, 0x13, 0xE5, 0x9C, 0x93, 0x38, 0x50, 0xA6,
    0x42, 0xE8, 0x36, 0x49, 0x96, 0xC3, 0xFB, 0xEC, 0x56, 0xC0, 0xE8, 0x6C,
    0x52, 0xD9, 0x12, 0xE2, 0x80, 0xC8, 0x18, 0x02, 0x76, 0x4C, 0xD5, 0x29,
    0x07, 0xA2, 0x4D, 0x09, 0xEC, 0xB4, 0xA6, 0xB1, 0x9F, 0xA5, 0x10, 0x60,
    0x9B, 0xE7, 0xBC, 0xA6, 0xB9, 0x18, 0x7B, 0x9C, 0x83, 0x79, 0xA6, 0x7B,
    0xE5, 0xE0, 0x00, 0x15, 0x11, 0x4A, 0x73, 0x44, 0x8D, 0x3B, 0x8B, 0x89,
    0x9A, 0x4B, 0x8F, 0x37, 0x95, 0x35, 0x9C, 0xD9, 0x29, 0xE8, 0x29, 0x65,
    0x5F, 0xD5, 0x0A, 0x35, 0xD2, 0x7F, 0x4B, 0x22, 0x91, 0x68, 0x6C, 0x12,
    0xC1, 0xEA, 0x0C, 0x4B, 0x15, 0x90, 0xF3, 0x75, 0xB1, 0x0C, 0x46, 0x60,
    0x10, 0x48, 0x5C, 0x7D, 0x89, 0x77, 0xB6, 0x7C, 0x3D, 0xA8, 0x1B, 0x64,
    0x64, 0x35, 0x20, 0x4D, 0xA3, 0x11, 0xF6, 0x04, 0x67, 0x8E, 0x78, 0x0D,
    0xB9, 0x38, 0x5C, 0x19, 0xE1, 0x3B, 0x56, 0x41, 0x5C, 0x0F, 0xCC, 0x01,
    0x29, 0xD7, 0x9D, 0x06, 0xB9, 0x57, 0xC4, 0x94, 0x55, 0xB0, 0x63, 0x3A,
    0x0B, 0x03, 0xC3, 0x13, 0x34, 0x47, 0x13, 0xBC, 0x54, 0x6E, 0x66, 0xAC,
    0x61, 0x28, 0x46, 0xDC, 0xD3, 0x96, 0x9B, 0x83, 0x9E, 0xEA, 0x4A, 0xBA,
    0xF4, 0x82, 0x7A, 0x0A, 0xEB, 0x81, 0xAE, 0x34, 0xC0, 0x5A, 0x5A, 0x8E,
    0x1D, 0x03, 0x6F, 0x93, 0x6A, 0x41, 0x86, 0x03, 0x9F, 0x68, 0xA0, 0xC4,
    0xA1, 0x38, 0xC7, 0xF0, 0x27, 0xCB, 0xAB, 0x58, 0x2D, 0x60, 0x14, 0x76,
    0xFE, 0xA2, 0xB3, 0x49, 0xDA, 0x7C, 0x02, 0x49, 0x76, 0x6A, 0xA1, 0x00,
    0xC0, 0x3C, 0x0A, 0xE6, 0x10, 0x51, 0xA4, 0x83, 0x6C, 0xA2, 0x26, 0x5D,
    0xEA, 0x56, 0x43, 0xB8, 0x52, 0x85, 0x3E, 0x3B, 0x86, 0x84, 0x4A, 0xA5,
    0xB4, 0xBA, 0xAD, 0x0E, 0x8B, 0x84, 0xDC, 0x32, 0x0C, 0xD1, 0xA9, 0xBF,
    0xD8, 0xA6, 0x43, 0xDB, 0x50, 0x0F, 0x00, 0x57, 0xCE, 0x7F, 0x9C, 0x39,
    0x3C, 0x10, 0xA5, 0xEF, 0x2C, 0x54, 0x33, 0x25, 0x45, 0x51, 0xE2, 0xA5,
    0xFD, 0xC7, 0x61, 0xF2, 0x98, 0x19, 0x5E, 0x43, 0x9B, 0x50, 0x29, 0x7F,
    0xC3, 0x98, 0x04, 0xDD, 0xC1, 0x23, 0xA2, 0x1B, 0x5C, 0x8D, 0xC0, 0xB8,
    0x82, 0xD0, 0x23, 0x23, 0x91, 0x5F, 0xBB, 0x05
};

#endif /* PQ_BLE_DEMO_PUBLIC_KEY_H_ */
```
