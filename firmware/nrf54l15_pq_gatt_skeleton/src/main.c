/*
 * PQ-BLE Handshake — nRF54L15 DK Firmware
 * ========================================
 *
 * GATT Peripheral for the PQ-BLE-HANDSHAKE protocol.
 *
 * MODE: DEMO_PRECOMPUTED_KEM
 *   The DK does NOT execute ML-KEM on-chip (that is future work).
 *   Instead, a precomputed ML-KEM-768 public key is hardcoded.
 *   The PC (Central) reads the public key, computes the ciphertext
 *   in Python, and writes it back. The DK validates the length,
 *   optionally compares with an expected ciphertext, and sends a
 *   precomputed AES-256-GCM encrypted payload via GATT Notify
 *   when it receives a START command on the Control characteristic.
 *
 * Hardware:  nRF54L15 DK (PCA10155)
 * Board:     nrf54l15dk/nrf54l15/cpuapp
 * SDK:       nRF Connect SDK >= 2.8.0 (Zephyr)
 *
 * Build:
 *   west build -b nrf54l15dk/nrf54l15/cpuapp -p always
 *   west flash
 *
 * GATT Service: 12345678-1234-1234-1234-123456789abc
 *   Public Key  (READ):    ...9abd  — ML-KEM-768 pk (1184 B, precomputed)
 *   Ciphertext  (WRITE):   ...9abe  — ML-KEM-768 ct (1088 B, fragmented)
 *   Secure Data (NOTIFY):  ...9abf  — AES-256-GCM encrypted payload
 *   Control     (WRITE):   ...9ac0  — START / SAS-confirm / resume
 *
 * Honesty note:
 *   This firmware validates the GATT transport layer only.
 *   Full embedded ML-KEM execution on nRF54L15 is FUTURE WORK.
 */

#include <zephyr/kernel.h>
#include <zephyr/bluetooth/bluetooth.h>
#include <zephyr/bluetooth/conn.h>
#include <zephyr/bluetooth/gatt.h>
#include <zephyr/bluetooth/uuid.h>
#include <zephyr/logging/log.h>
#include <string.h>

LOG_MODULE_REGISTER(pq_ble, LOG_LEVEL_INF);

/* ── Device name ── */
#define DEVICE_NAME         "PQ-BLE-Device"
#define DEVICE_NAME_LEN     (sizeof(DEVICE_NAME) - 1)

/* ── Custom 128-bit UUIDs (match Python src/common/constants.py) ──
 *
 * BT_UUID_128_ENCODE(w32, w16_1, w16_2, w16_3, w48)
 * UUID: 12345678-1234-1234-1234-123456789abc
 */
#define PQ_SERVICE_UUID \
    BT_UUID_128_ENCODE(0x12345678, 0x1234, 0x1234, 0x1234, 0x123456789abc)

#define PQ_CHAR_PUBKEY_UUID \
    BT_UUID_128_ENCODE(0x12345678, 0x1234, 0x1234, 0x1234, 0x123456789abd)

#define PQ_CHAR_CIPHERTEXT_UUID \
    BT_UUID_128_ENCODE(0x12345678, 0x1234, 0x1234, 0x1234, 0x123456789abe)

#define PQ_CHAR_DATA_UUID \
    BT_UUID_128_ENCODE(0x12345678, 0x1234, 0x1234, 0x1234, 0x123456789abf)

#define PQ_CHAR_CONTROL_UUID \
    BT_UUID_128_ENCODE(0x12345678, 0x1234, 0x1234, 0x1234, 0x123456789ac0)

/* ── Protocol constants (match Python constants.py) ── */
#define ML_KEM_PK_SIZE       1184
#define ML_KEM_CT_SIZE       1088
#define FRAG_HEADER_SIZE     4     /* idx(1) + total(1) + len(2 BE) */
#define MAX_FRAGMENTS        8     /* 1184 B / 508 B ≈ 3 fragments */
#define MAX_FRAG_PAYLOAD     512

/* Control commands (ASCII, match Python parse_control_message) */
#define CTRL_START           "START"
#define CTRL_START_LEN       5
#define CTRL_SAS_OK          "OK"
#define CTRL_SAS_OK_LEN      2
#define RESUME_MAGIC         "PQBL"
#define RESUME_MAGIC_LEN     4
#define RESUME_REQ_BYTE      0x01

/* ── DEMO_PRECOMPUTED_KEM data ──
 *
 * In a real demo, these are generated by:
 *   python scripts/generate_demo_vectors.py
 * and pasted here. The placeholder below uses a repeating
 * pattern — NOT a valid ML-KEM key. Replace with real vectors
 * before flashing.
 */
static uint8_t demo_pk[ML_KEM_PK_SIZE] = {
    /* Placeholder: repeating 0xAB pattern.
     * Replace with output of generate_demo_vectors.py. */
    0xAB, [1 ... ML_KEM_PK_SIZE - 2] = 0xAB, [ML_KEM_PK_SIZE - 1] = 0xBA
};

/* Precomputed AES-256-GCM encrypted payload (demo only).
 * Format: seq(8) || msg_type(1) || iv(12) || ciphertext || tag(16)
 * Generated by the same Python script.
 * This is a 37-byte demo payload ("Hello from nRF54L15!" + overhead). */
static uint8_t demo_notify_payload[] = {
    /* Placeholder — replace with real encrypted payload */
    0x00, 0x00, 0x00, 0x00, 0x00, 0x00, 0x00, 0x00,  /* seq */
    0x01,                                              /* msg_type = DATA */
    0x00, 0x00, 0x00, 0x00, 0x00, 0x00, 0x00, 0x00,  /* iv */
    0x00, 0x00, 0x00, 0x00,                            /* iv cont */
    /* ciphertext placeholder — "Hello from nRF54L15!" (20 bytes) */
    0x00, 0x00, 0x00, 0x00, 0x00, 0x00, 0x00, 0x00,
    0x00, 0x00, 0x00, 0x00, 0x00, 0x00, 0x00, 0x00,
    0x00, 0x00, 0x00, 0x00,
    /* tag placeholder (16 bytes) */
    0x00, 0x00, 0x00, 0x00, 0x00, 0x00, 0x00, 0x00,
    0x00, 0x00, 0x00, 0x00, 0x00, 0x00, 0x00, 0x00,
};

/* Expected ciphertext (optional validation — set to all-zero to skip) */
static uint8_t expected_ct[ML_KEM_CT_SIZE];  /* zero-initialized = skip */

/* ── Buffers ── */
static uint8_t ct_buffer[ML_KEM_CT_SIZE];
static uint8_t ct_fragments[MAX_FRAGMENTS][MAX_FRAG_PAYLOAD + FRAG_HEADER_SIZE];
static uint8_t ct_frag_received[MAX_FRAGMENTS];
static uint8_t ct_frag_total = 0;
static uint16_t ct_frag_lens[MAX_FRAGMENTS];
static bool ct_ready = false;
static bool notify_enabled = false;

/* ── Connection ── */
static struct bt_conn *current_conn = NULL;

/* ── Forward declarations ── */
static ssize_t read_public_key(struct bt_conn *conn,
                               const struct bt_gatt_attr *attr,
                               void *buf, uint16_t len, uint16_t offset);
static ssize_t write_ciphertext(struct bt_conn *conn,
                                const struct bt_gatt_attr *attr,
                                const void *buf, uint16_t len,
                                uint16_t offset, uint8_t flags);
static ssize_t write_control(struct bt_conn *conn,
                             const struct bt_gatt_attr *attr,
                             const void *buf, uint16_t len,
                             uint16_t offset, uint8_t flags);
static void ccc_config_changed(const struct bt_gatt_attr *attr,
                               uint16_t value);
static void send_demo_notify(void);

/* ── Advertising data ── */
static const struct bt_data ad[] = {
    BT_DATA_BYTES(BT_DATA_FLAGS, (BT_LE_AD_GENERAL | BT_LE_AD_NO_BREDR)),
    BT_DATA(BT_DATA_NAME_COMPLETE, DEVICE_NAME, DEVICE_NAME_LEN),
};

/* ── GATT Service Definition ──
 *
 * Attribute index reference (0-based within pq_service):
 *   [0] Primary Service declaration
 *   [1] Public Key characteristic declaration
 *   [2] Public Key characteristic value
 *   [3] Ciphertext characteristic declaration
 *   [4] Ciphertext characteristic value
 *   [5] Data characteristic declaration
 *   [6] Data characteristic value
 *   [7] CCCD for Data notifications
 *   [8] Control characteristic declaration
 *   [9] Control characteristic value
 */
BT_GATT_SERVICE_DEFINE(
    pq_service,

    BT_GATT_PRIMARY_SERVICE(BT_UUID_DECLARE_128(PQ_SERVICE_UUID)),

    /* Public Key — READ */
    BT_GATT_CHARACTERISTIC(
        BT_UUID_DECLARE_128(PQ_CHAR_PUBKEY_UUID),
        BT_GATT_CHRC_READ,
        BT_GATT_PERM_READ,
        read_public_key, NULL, NULL
    ),

    /* Ciphertext — WRITE (with response) */
    BT_GATT_CHARACTERISTIC(
        BT_UUID_DECLARE_128(PQ_CHAR_CIPHERTEXT_UUID),
        BT_GATT_CHRC_WRITE,
        BT_GATT_PERM_WRITE,
        NULL, write_ciphertext, NULL
    ),

    /* Secure Data — NOTIFY */
    BT_GATT_CHARACTERISTIC(
        BT_UUID_DECLARE_128(PQ_CHAR_DATA_UUID),
        BT_GATT_CHRC_NOTIFY,
        BT_GATT_PERM_NONE,
        NULL, NULL, NULL
    ),
    /* CCCD for notifications */
    BT_GATT_CCC(ccc_config_changed,
                BT_GATT_PERM_READ | BT_GATT_PERM_WRITE),

    /* Control — WRITE */
    BT_GATT_CHARACTERISTIC(
        BT_UUID_DECLARE_128(PQ_CHAR_CONTROL_UUID),
        BT_GATT_CHRC_WRITE,
        BT_GATT_PERM_WRITE,
        NULL, write_control, NULL
    ),
);

/* ── GATT Callbacks ── */

static ssize_t read_public_key(struct bt_conn *conn,
                               const struct bt_gatt_attr *attr,
                               void *buf, uint16_t len, uint16_t offset)
{
    LOG_INF("PK read: offset=%u, len=%u", offset, len);
    return bt_gatt_attr_read(conn, attr, buf, len, offset,
                             demo_pk, sizeof(demo_pk));
}

static ssize_t write_ciphertext(struct bt_conn *conn,
                                const struct bt_gatt_attr *attr,
                                const void *buf, uint16_t len,
                                uint16_t offset, uint8_t flags)
{
    LOG_INF("CT write: offset=%u, len=%u", offset, len);

    if (len < FRAG_HEADER_SIZE) {
        LOG_ERR("CT fragment too short: %u < %u", len, FRAG_HEADER_SIZE);
        return BT_GATT_ERR(BT_ATT_ERR_INVALID_ATTRIBUTE_LEN);
    }

    /* Parse fragment header: [idx:1][total:1][payload_len:2 BE] */
    const uint8_t *data = (const uint8_t *)buf;
    uint8_t idx = data[0];
    uint8_t total = data[1];
    uint16_t payload_len = (data[2] << 8) | data[3];

    /* Validate */
    if (idx >= MAX_FRAGMENTS || total > MAX_FRAGMENTS || total == 0) {
        LOG_ERR("CT fragment idx/total invalid: idx=%u total=%u",
                idx, total);
        return BT_GATT_ERR(BT_ATT_ERR_INVALID_ATTRIBUTE_LEN);
    }

    if (payload_len != (len - FRAG_HEADER_SIZE)) {
        LOG_ERR("CT payload_len mismatch: header=%u, actual=%u",
                payload_len, len - FRAG_HEADER_SIZE);
        return BT_GATT_ERR(BT_ATT_ERR_INVALID_ATTRIBUTE_LEN);
    }

    if (payload_len > MAX_FRAG_PAYLOAD) {
        LOG_ERR("CT payload too large: %u > %u", payload_len, MAX_FRAG_PAYLOAD);
        return BT_GATT_ERR(BT_ATT_ERR_INVALID_ATTRIBUTE_LEN);
    }

    /* Store fragment */
    ct_frag_total = total;
    ct_frag_received[idx] = 1;
    ct_frag_lens[idx] = payload_len;
    memcpy(ct_fragments[idx], data + FRAG_HEADER_SIZE, payload_len);

    LOG_INF("CT fragment %u/%u stored (%u bytes payload)",
            idx + 1, ct_frag_total, payload_len);

    /* Check if all fragments received */
    bool all_received = true;
    for (int i = 0; i < ct_frag_total; i++) {
        if (!ct_frag_received[i]) {
            all_received = false;
            break;
        }
    }

    if (all_received && ct_frag_total > 0) {
        /* Reassemble into ct_buffer */
        uint16_t offset_ct = 0;
        for (int i = 0; i < ct_frag_total; i++) {
            if (offset_ct + ct_frag_lens[i] > ML_KEM_CT_SIZE) {
                LOG_ERR("CT reassembly overflow: %u > %u",
                        offset_ct + ct_frag_lens[i], ML_KEM_CT_SIZE);
                return BT_GATT_ERR(BT_ATT_ERR_INVALID_ATTRIBUTE_LEN);
            }
            memcpy(ct_buffer + offset_ct, ct_fragments[i], ct_frag_lens[i]);
            offset_ct += ct_frag_lens[i];
        }

        ct_ready = true;
        LOG_INF("✅ All %u CT fragments reassembled: %u bytes",
                ct_frag_total, offset_ct);

        /* Optional: validate against expected_ct */
        bool has_expected = false;
        for (int i = 0; i < ML_KEM_CT_SIZE; i++) {
            if (expected_ct[i] != 0) {
                has_expected = true;
                break;
            }
        }
        if (has_expected) {
            if (memcmp(ct_buffer, expected_ct, ML_KEM_CT_SIZE) == 0) {
                LOG_INF("CT matches expected ciphertext ✓");
            } else {
                LOG_WRN("CT does NOT match expected ciphertext");
            }
        }
    }

    return len;
}

static ssize_t write_control(struct bt_conn *conn,
                             const struct bt_gatt_attr *attr,
                             const void *buf, uint16_t len,
                             uint16_t offset, uint8_t flags)
{
    const uint8_t *data = (const uint8_t *)buf;

    LOG_INF("Control write: len=%u", len);
    LOG_HEXDUMP_INF(data, len, "Control data");

    /* START command — trigger demo notify */
    if (len == CTRL_START_LEN && memcmp(data, CTRL_START, CTRL_START_LEN) == 0) {
        LOG_INF("Received START command");
        if (!ct_ready) {
            LOG_WRN("START received but ciphertext not yet written");
            return len;
        }
        if (!notify_enabled) {
            LOG_WRN("START received but notifications not enabled (CCCD)");
            return len;
        }
        send_demo_notify();
        return len;
    }

    /* SAS confirmation "OK" */
    if (len == CTRL_SAS_OK_LEN && memcmp(data, CTRL_SAS_OK, CTRL_SAS_OK_LEN) == 0) {
        LOG_INF("SAS confirmation received");
        return len;
    }

    /* Resume request: PQBL (4) + 0x01 (1) + session_id (16) = 21 bytes */
    if (len == (RESUME_MAGIC_LEN + 1 + 16) &&
        memcmp(data, RESUME_MAGIC, RESUME_MAGIC_LEN) == 0 &&
        data[RESUME_MAGIC_LEN] == RESUME_REQ_BYTE) {
        LOG_INF("Resume request received (session_id in payload)");
        /* TODO: look up session_id in persistent store.
         * For now, just log it. Full resume support requires
         * flash storage on the DK. */
        return len;
    }

    LOG_WRN("Unknown control message");
    return len;
}

static void ccc_config_changed(const struct bt_gatt_attr *attr,
                               uint16_t value)
{
    notify_enabled = (value == BT_GATT_CCC_NOTIFY);
    LOG_INF("Notifications %s", notify_enabled ? "ENABLED" : "DISABLED");
}

/* ── Send precomputed demo notification ── */
static void send_demo_notify(void)
{
    if (!current_conn) {
        LOG_ERR("Cannot notify: no active connection");
        return;
    }
    if (!notify_enabled) {
        LOG_ERR("Cannot notify: CCCD not enabled");
        return;
    }

    /* Notify on the Data characteristic (attribute index 6 in pq_service).
     * BT_GATT_SERVICE_DEFINE puts the characteristic value at a known
     * offset. We use &pq_service.attrs[6] for the Data characteristic
     * value attribute.
     *
     * NOTE: The exact index depends on the service definition order.
     *       Verify with bt_gatt_attr_get_uuid() if uncertain. */
    int err = bt_gatt_notify(current_conn, &pq_service.attrs[6],
                             demo_notify_payload,
                             sizeof(demo_notify_payload));
    if (err) {
        LOG_ERR("bt_gatt_notify failed: %d", err);
    } else {
        LOG_INF("✅ Demo notification sent: %u bytes",
                sizeof(demo_notify_payload));
    }
}

/* ── Connection callbacks ── */

static void connected(struct bt_conn *conn, uint8_t err)
{
    if (err) {
        LOG_ERR("Connection failed (err %u)", err);
        return;
    }
    current_conn = bt_conn_ref(conn);
    LOG_INF("Connected!");
}

static void disconnected(struct bt_conn *conn, uint8_t reason)
{
    LOG_INF("Disconnected (reason %u)", reason);
    if (current_conn) {
        bt_conn_unref(current_conn);
        current_conn = NULL;
    }

    /* Reset state for next connection */
    ct_frag_total = 0;
    ct_ready = false;
    notify_enabled = false;
    memset(ct_frag_received, 0, sizeof(ct_frag_received));
    memset(ct_frag_lens, 0, sizeof(ct_frag_lens));
    memset(ct_buffer, 0, sizeof(ct_buffer));
}

BT_CONN_CB_DEFINE(conn_callbacks) = {
    .connected = connected,
    .disconnected = disconnected,
};

/* ── MTU update callback ── */
static void mtu_updated(struct bt_conn *conn, uint16_t tx, uint16_t rx)
{
    LOG_INF("MTU updated: TX=%u, RX=%u", tx, rx);
}

static struct bt_gatt_cb gatt_callbacks = {
    .att_mtu_updated = mtu_updated,
};

/* ── Main ── */

void main(void)
{
    int err;

    LOG_INF("========================================");
    LOG_INF("PQ-BLE Handshake — nRF54L15 DK Peripheral");
    LOG_INF("Mode: DEMO_PRECOMPUTED_KEM");
    LOG_INF("Device: %s", DEVICE_NAME);
    LOG_INF("========================================");

    /* Initialize Bluetooth */
    err = bt_enable(NULL);
    if (err) {
        LOG_ERR("bt_enable failed (err %d)", err);
        return;
    }
    LOG_INF("Bluetooth initialized.");

    bt_gatt_cb_register(&gatt_callbacks);

    /* Start advertising */
    err = bt_le_adv_start(BT_LE_ADV_CONN, ad, ARRAY_SIZE(ad), NULL, 0);
    if (err) {
        LOG_ERR("Advertising failed (err %d)", err);
        return;
    }

    LOG_INF("Advertising as '%s'. Waiting for Central...", DEVICE_NAME);
    LOG_INF("PK size: %d bytes, CT size: %d bytes",
            ML_KEM_PK_SIZE, ML_KEM_CT_SIZE);

    /* Main loop — restart advertising if disconnected */
    while (1) {
        k_sleep(K_SECONDS(1));
        if (!current_conn) {
            bt_le_adv_start(BT_LE_ADV_CONN, ad, ARRAY_SIZE(ad), NULL, 0);
        }
    }
}
